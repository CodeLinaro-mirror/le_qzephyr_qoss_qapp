## bmps_app/sample.yaml
```yaml
sample:
  description: QCC730 Bmps app
    application
  name: bmps app 
common:
  tags: introduction
  harness: console
```

## common/at_commands/Kconfig
```kconfig
# Copyright (c) Qualcomm Technologies, Inc. and/or its subsidiaries.
# SPDX-License-Identifier: BSD-3-Clause-Clear

config QAT_COMMON
	bool "QAT Common AT Commands"
	depends on QAT
	default y
	help
	  Enable common AT commands for QAT module.
	  This provides basic AT commands.
	  Requires both QAT and QAT_COMMON to be enabled.

config QAT_WLAN
	bool "QAT WiFi AT Commands"
	depends on QAT && WIFI
	select NET_MGMT
	select NET_MGMT_EVENT
	select NET_MGMT_EVENT_INFO
	default y
	help
	  Enable WiFi related AT commands for QAT module.
	  This provides commands like AT+CWJAP for WiFi connection.
	  Uses Zephyr's standard WiFi management APIs.

config QAT_TCPIP
	bool "QAT TCP/IP AT Commands"
	depends on QAT
	default y
	help
	  Enable TCP/IP related AT commands for QAT module.
	  This provides commands like AT+CIPSEND for data passthrough mode.

config QAT_HTTPC
	bool "QAT HTTP Client AT Commands"
	depends on QAT && HTTPC_AT
	default y
	help
	  Enable HTTP client AT commands for QAT module.
	  This provides AT+HTTPCLIENT/HTTPGETSIZE/HTTPGET/HTTPPOST/HTTPPUT/
	  HTTPURLCFG/HTTPSSLCFG/HTTPNETCFG.

config QAT_FSTORE
	bool "QAT File Store AT Commands"
	depends on QAT && FILE_SYSTEM
	default y
	help
	  Enable file storage AT commands for QAT module.
	  This provides AT+WRITEFILE/READFILE/DELFILE to transfer and manage
	  files on the QCC730 LittleFS filesystem from the host side.

config QAT_WIFI_CRED
	bool "QAT WiFi Credential Persistence"
	depends on QAT_WLAN && FILE_SYSTEM
	default y
	help
	  Enable WiFi credential persistence commands for QAT module.
	  This provides AT+CWSAVE/CWLOAD to store and restore SSID, passphrase,
	  and security parameters to the QCC730 LittleFS filesystem.

config QAT_HTTPSERVER
	bool "QAT HTTP Server AT Commands"
	depends on QAT && HTTP_SERVER && NET_SOCKETS_SOCKOPT_TLS && TLS_CREDENTIALS
	select FDTABLE
	default n
	help
	  Enable AT+WEBSERVER, AT+WEBSERVERCFG and AT+SYSCFG commands plus five
	  HTTP URI handlers for WiFi provisioning. Both plain HTTP and HTTPS are
	  supported at runtime via AT+WEBSERVERCFG (scheme=0 for HTTP, 1 for HTTPS,
	  2 for mutual TLS). HTTP and HTTPS service instances are always compiled in;
	  AT+WEBSERVER activates the appropriate one at runtime without recompiling.

config QAT_OTA
	bool "QAT OTA Firmware Upgrade AT Commands"
	depends on QAT && QCOM_FW_UPGRADE
	select NET_TCP
	help
	  Enable AT+OTAFWUP and AT+OTATRIAL commands for over-the-air firmware
	  upgrade via HTTP. Requires the QCOM image management backend and a
	  TCP/IP stack. Not enabled by default; must be opted in via prj.conf
	  or board defconfig.

config QAT_OTA_STACK_SIZE
	int "OTA worker thread stack size (bytes)"
	depends on QAT_OTA
	default 4096
	help
	  Stack size for the dedicated OTA download thread. Must be large enough
	  to accommodate the httpc_at_execute() stack frame and the mbedTLS SHA-256
	  context used by fw_upgrade_session_process(). 4096 bytes is the minimum.

config QAT_OTA_THREAD_PRIORITY
	int "OTA worker thread cooperative priority"
	depends on QAT_OTA
	default 5
	help
	  Zephyr thread priority for the OTA worker thread. Lower values are higher
	  priority. Non-negative values are preemptive. Default 5 is preemptive and
	  runs below the system workqueue (0) and the AT service thread.

config QAT_MQTTC
	bool "QAT MQTT Client AT Commands"
	depends on QAT && MQTTC_AT
	default y
	help
	  Enable MQTT client AT commands for QAT module.
	  This provides AT+MQTTINIT/MQTTCONN/MQTTSUB/MQTTPUB/MQTTPUBRAW/
	  MQTTUNSUB/MQTTDISCONN/MQTTDESTROY/MQTTMODE.
```

## common/httpc_at/Kconfig
```kconfig
# Copyright (c) 2026 Qualcomm Innovation Center, Inc. All rights reserved.
# SPDX-License-Identifier: BSD-3-Clause-Clear

config HTTPC_AT
	bool "HTTP/HTTPS AT command handler"
	depends on NETWORKING
	depends on NET_SOCKETS
	depends on DNS_RESOLVER
	select HTTP_CLIENT
	select TLS_CREDENTIALS if HTTPC_AT_TLS
	help
	  Enable the HTTP/HTTPS AT command handler module.
	  Provides AT+HTTPCLIENT, AT+HTTPGETSIZE, AT+HTTPGET,
	  AT+HTTPPOST, AT+HTTPPUT, AT+HTTPURLCFG, AT+HTTPSSLCFG,
	  and AT+HTTPNETCFG
	  command handlers using Zephyr's http_client_req() API.

if HTTPC_AT

config HTTPC_AT_TLS
        bool "TLS/HTTPS support for HTTPC AT handler"
        depends on NET_SOCKETS_SOCKOPT_TLS
        depends on FILE_SYSTEM
        default y
        help
          Enable TLS/HTTPS support. When enabled, AT+HTTPSSLCFG can be
          used to configure certificates for HTTPS connections.
          Certificates are loaded from the Zephyr filesystem at connection
          time using the TLS credentials subsystem.

config HTTPC_AT_LOG_LEVEL
	int "Log level for HTTPC AT handler"
	default 3
	range 0 4
	help
	  Sets the log level for all httpc_at_* modules.
	  0=OFF, 1=ERR, 2=WRN, 3=INF, 4=DBG

endif # HTTPC_AT
```

## common/mcumgr_qcom/Kconfig
```kconfig
# Copyright (c) 2024 Qualcomm Technologies, Inc.
# SPDX-License-Identifier: BSD-3-Clause-Clear

config QCOM_FW_UPGRADE
	bool "Qualcomm Firmware Upgrade Engine"
	depends on FLASH
	select MBEDTLS
	select MBEDTLS_SHA256
	help
	  Enables the low-level firmware upgrade engine (fw_upgrade.c,
	  fw_upgrade_mem.c, flash_adapter.c) without the MCUmgr protocol stack.
	  Required by CONFIG_QAT_OTA. Automatically selected by QCOM_IMG_MGMT.

menuconfig QCOM_IMG_MGMT
	bool "Qualcomm Custom Image Management"
	depends on FLASH
	depends on MCUMGR
	select QCOM_FW_UPGRADE
	select MCUMGR_SMP_CBOR_MIN_DECODING_LEVEL_2
	select MCUMGR_SMP_CBOR_MIN_ENCODING_LEVEL_2
	select CRC
	select BASE64
	select MCUMGR_GRP_OS
	select MCUMGR_GRP_OS_TASKSTAT
	select MCUMGR_GRP_OS_ECHO
	select MCUMGR_TRANSPORT_UDP
	select MCUMGR_TRANSPORT_UDP_IPV4
	help
	  Enable custom image management without MCUboot dependency.
	  This provides firmware update capability through MCUmgr.
	  
	  This automatically enables required MCUmgr dependencies including:
	  - Base64 encoding support
	  - CRC calculation support
	  - MCUmgr OS group for system management
	  - UDP transport for network-based management
	  
	  Note: ZCBOR is automatically enabled by MCUMGR dependency.

if QCOM_IMG_MGMT

# ============================================
# ZCBOR Configuration
# ============================================
config QCOM_IMG_MGMT_ZCBOR_MAX_STR_LEN
	int "Maximum ZCBOR string length"
	default 1024
	help
	  Maximum string length for ZCBOR operations.
	  Increased to support larger binary data transfers.

# Map to standard Zephyr config
config ZCBOR_MAX_STR_LEN
	default QCOM_IMG_MGMT_ZCBOR_MAX_STR_LEN

# ============================================
# MCUmgr Transport Configuration
# ============================================
config QCOM_IMG_MGMT_UDP_PORT
	int "MCUmgr UDP port"
	default 1337
	help
	  UDP port for MCUmgr communication.

config QCOM_IMG_MGMT_UDP_MTU
	int "MCUmgr UDP MTU size"
	default 1500
	help
	  Maximum transmission unit for UDP transport.

config QCOM_IMG_MGMT_NETBUF_COUNT
	int "MCUmgr network buffer count"
	default 4
	help
	  Number of network buffers for MCUmgr transport.

config QCOM_IMG_MGMT_NETBUF_SIZE
	int "MCUmgr network buffer size"
	default 4096
	help
	  Size of each network buffer for MCUmgr transport.
	  Increased to support larger CBOR payloads (e.g., 512-byte data chunks).

# Map to standard Zephyr configs
config MCUMGR_TRANSPORT_UDP_PORT
	default QCOM_IMG_MGMT_UDP_PORT

config MCUMGR_TRANSPORT_UDP_MTU
	default QCOM_IMG_MGMT_UDP_MTU

config MCUMGR_TRANSPORT_NETBUF_COUNT
	default QCOM_IMG_MGMT_NETBUF_COUNT

config MCUMGR_TRANSPORT_NETBUF_SIZE
	default QCOM_IMG_MGMT_NETBUF_SIZE

# ============================================
# Crypto Configuration
# ============================================
config QCOM_IMG_MGMT_SHA256_SUPPORT
	bool "Enable sha256 support for image verification"
	default y
	select MBEDTLS
	select MBEDTLS_SHA256
	help
	  Enable SHA256 support for image verification.

# ============================================
# Logging Configuration
# ============================================
module = QCOM_IMG_MGMT
module-str = qcom_img_mgmt
source "subsys/logging/Kconfig.template.log_config"

endif # QCOM_IMG_MGMT
```

## common/mqttc_at/Kconfig
```kconfig
# Copyright (c) 2026 Qualcomm Innovation Center, Inc. All rights reserved.
# SPDX-License-Identifier: BSD-3-Clause-Clear

config MQTTC_AT
	bool "MQTT client AT command handler"
	depends on NETWORKING
	depends on NET_SOCKETS
	depends on DNS_RESOLVER
	depends on MQTT_LIB
	help
	  Enable the MQTT client AT command handler module.
	  Provides AT+MQTTINIT, AT+MQTTCONN, AT+MQTTSUB, AT+MQTTPUB,
	  AT+MQTTPUBRAW, AT+MQTTUNSUB, AT+MQTTDISCONN, AT+MQTTDESTROY,
	  and AT+MQTTMODE command handlers using Zephyr's MQTT library.

if MQTTC_AT

config MQTTC_AT_LOG_LEVEL
	int "Log level for MQTTC AT handler"
	default 3
	range 0 4
	help
	  Sets the log level for mqttc_at modules.
	  0=OFF, 1=ERR, 2=WRN, 3=INF, 4=DBG

config MQTTC_AT_MAX_SESSIONS
	int "Maximum number of concurrent MQTT sessions"
	default 2
	range 1 2
	help
	  Maximum number of concurrent MQTT sessions (session_id 0 and 1).

config MQTTC_AT_MAX_TOPICS
	int "Maximum subscribed topics per session"
	default 10
	range 1 10
	help
	  Maximum number of topics that can be subscribed per session.

config MQTTC_AT_RECV_THREAD_STACK_SIZE
	int "MQTT receive thread stack size (bytes)"
	default 2048
	help
	  Stack size for the per-session MQTT receive/keepalive thread.

endif # MQTTC_AT
```

## common/pm_service/Kconfig
```kconfig
# Copyright (c) Qualcomm Technologies, Inc. and/or its subsidiaries.
# SPDX-License-Identifier: BSD-3-Clause-Clear

config QPM_AUTO_SLEEP
    bool "QCOM AUTO SLEEP"
    depends on PM && PM_DEVICE && PM_DEVICE_SYSTEM_MANAGED
	default n
```

## common/shell/Kconfig
```kconfig
# Copyright (c) Qualcomm Technologies, Inc. and/or its subsidiaries.
# SPDX-License-Identifier: BSD-3-Clause-Clear

config SIGMADUT_TRAFFIC
	bool "Sigma DUT UDP traffic test"
	default n
	depends on NET_SOCKETS
	help
	  Enable the Sigma DUT UDP TX/RX traffic test commands under the
	  wificert shell group.
```

## qcc730testing/tests/drivers/clock_control/clock_control_stress/testcase.yaml
```yaml
# SPDX-License-Identifier: BSD-3-Clause-Clear
# Copyright (c) Qualcomm Technologies, Inc. and/or its subsidiaries.

common:
  tags:
    - drivers
    - clock
  harness: ztest
  timeout: 70
tests:
  drivers.clock_control.qcc730.stress:
    platform_allow:
      - qcc730mi
```

## qcc730testing/tests/drivers/counter/qcc730_qtmr/testcase.yaml
```yaml
# Copyright (c) Qualcomm Technologies, Inc. and/or its subsidiaries.
# SPDX-License-Identifier: BSD-3-Clause

tests:
  drivers.counter.qcc730_qtmr:
    harness: ztest
    platform_allow:
      - qcc730mi
    timeout: 180
```

## qcc730testing/tests/drivers/counter/qcc730_qtmr_stress/testcase.yaml
```yaml
# SPDX-License-Identifier: BSD-3-Clause-Clear
# Copyright (c) Qualcomm Technologies, Inc. and/or its subsidiaries.

common:
  tags:
    - drivers
    - counter
  harness: ztest
  platform_allow: qcc730mi
  timeout: 70
tests:
  drivers.counter.qcc730.stress:
    platform_allow:
      - qcc730mi
    extra_configs:
      - CONFIG_COUNTER_QCC730=y
```

## qcc730testing/tests/drivers/dma/dma_stress/testcase.yaml
```yaml
# SPDX-License-Identifier: BSD-3-Clause-Clear
# Copyright (c) Qualcomm Technologies, Inc. and/or its subsidiaries.

common:
  tags:
    - drivers
    - dma
  harness: ztest
  timeout: 70
tests:
  drivers.dma.qcc730.stress:
    platform_allow:
      - qcc730mi
```

## qcc730testing/tests/drivers/dma/qcc730_dxe/testcase.yaml
```yaml
# SPDX-License-Identifier: BSD-3-Clause-Clear
# Copyright (c) Qualcomm Technologies, Inc. and/or its subsidiaries.

tests:
  drivers.dma.qcc730_dxe:
    platform_allow:
      - qcc730mi
    tags:
      - drivers
      - dma
      - qcc730
    harness: ztest
```

## qcc730testing/tests/drivers/dma/qcc730_dxe_pm/testcase.yaml
```yaml
# SPDX-License-Identifier: BSD-3-Clause
# Copyright (c) 2025 Qualcomm Technologies, Inc.

tests:
  drivers.dma.qcc730_dxe_pm:
    platform_allow:
      - qcc730mi
    tags:
      - drivers
      - dma
      - qcc730
    harness: ztest
```

## qcc730testing/tests/drivers/flash/common/boards/qcc730mi.conf
```kconfig
CONFIG_TEST_DRIVER_FLASH_SIZE=4194304
CONFIG_FLASH_PAGE_LAYOUT=y
CONFIG_PM_DEVICE=y
```

## qcc730testing/tests/drivers/flash/flash_stress/testcase.yaml
```yaml
# SPDX-License-Identifier: BSD-3-Clause-Clear
# Copyright (c) Qualcomm Technologies, Inc. and/or its subsidiaries.

tests:
  drivers.flash.qcc730.flash_stress:
    tags: flash
    platform_allow: qcc730mi
    harness: ztest
    timeout: 180
```

## qcc730testing/tests/drivers/gpio/gpio_stress/testcase.yaml
```yaml
# SPDX-License-Identifier: Apache-2.0
# Copyright (c) 2025 Qualcomm Technologies, Inc.

tests:
  drivers.gpio.qcc730.gpio_stress:
    tags: gpio
    platform_allow: qcc730mi
    harness: ztest
    timeout: 120
    extra_configs:
      - CONFIG_ZTRESS=y
      - CONFIG_GPIO_QCC730_INTERRUPT=y
```

## qcc730testing/tests/drivers/i2c/i2c_lis2dw12/testcase.yaml
```yaml
# SPDX-License-Identifier: BSD-3-Clause
# Copyright (c) 2025 Qualcomm Technologies, Inc.

common:
  depends_on: i2c
  tags:
    - sensor
    - drivers
  harness: ztest
  harness_config:
    fixture: i2c_lis2dw12
tests:
  sensor.lis2dw12.api_polling:
    filter: dt_compat_enabled("st,lis2dw12")
    platform_allow:
      - qcc730mi
    extra_configs:
      - CONFIG_I2C_QCC730_INTERRUPT_SUPPORT=n
  sensor.lis2dw12.api_interrupt:
    filter: dt_compat_enabled("st,lis2dw12")
    platform_allow:
      - qcc730mi
    extra_configs:
      - CONFIG_I2C_QCC730_INTERRUPT_SUPPORT=y
      - CONFIG_LOG=y
      - CONFIG_I2C_LOG_LEVEL_DBG=y
      - CONFIG_SENSOR_LOG_LEVEL_DBG=y
```

## qcc730testing/tests/drivers/i2c/i2c_stress/testcase.yaml
```yaml
# SPDX-License-Identifier: BSD-3-Clause-Clear
# Copyright (c) Qualcomm Technologies, Inc. and/or its subsidiaries.

common:
  depends_on: i2c
  tags:
    - sensor
    - drivers
    - i2c
  harness: ztest
  timeout: 180
tests:
  drivers.i2c.qcc730.i2c_stress_polling:
    platform_allow:
      - qcc730mi
    extra_configs:
      - CONFIG_I2C_QCC730_INTERRUPT_SUPPORT=n
  drivers.i2c.qcc730.i2c_stress_interrupt:
    platform_allow:
      - qcc730mi
    extra_configs:
      - CONFIG_I2C_QCC730_INTERRUPT_SUPPORT=y
```

## qcc730testing/tests/drivers/pinctrl/qcc730mi/testcase.yaml
```yaml
# Copyright (c) Qualcomm Technologies, Inc. and/or its subsidiaries.
# SPDX-License-Identifier: BSD-3-Clause

tests:
  drivers.pinctrl.qcc730_pinctrl:
    tags:
      - drivers
      - pinctrl
    platform_allow:
      - qcc730mi
    harness: ztest
```

## qcc730testing/tests/drivers/reset/qcc730_reset/testcase.yaml
```yaml
# Copyright (c) Qualcomm Technologies, Inc. and/or its subsidiaries.
# SPDX-License-Identifier: BSD-3-Clause

tests:
  drivers.reset.test_reset_qcc730:
    harness: ztest
    platform_allow:
      - qcc730mi
```

## qcc730testing/tests/drivers/rtc/rtc_api/boards/qcc730mi.conf
```kconfig
CONFIG_COUNTER=y
CONFIG_RTC=y
CONFIG_LOG=y
CONFIG_COUNTER_LOG_LEVEL_DBG=y
CONFIG_RTC_LOG_LEVEL_DBG=y
CONFIG_RTC_ALARM=y
```

## qcc730testing/tests/drivers/rtc/rtc_stress/testcase.yaml
```yaml
# SPDX-License-Identifier: BSD-3-Clause-Clear
# Copyright (c) Qualcomm Technologies, Inc. and/or its subsidiaries.

common:
  tags:
    - drivers
    - rtc
  harness: ztest
  platform_allow: qcc730mi
  timeout: 70
tests:
  drivers.rtc.qcc730.stress:
    platform_allow:
      - qcc730mi
```

## qcc730testing/tests/drivers/uart/uart_loopback/testcase.yaml
```yaml
# Copyright (c) Qualcomm Technologies, Inc. and/or its subsidiaries.
# SPDX-License-Identifier: BSD-3-Clause-Clear

common:
  tags:
    - drivers
    - uart
  platform_allow: qcc730mi
  timeout: 50
tests:
  drivers.uart.qcc730.loopback_validation:
    platform_allow:
      - qcc730mi
```
