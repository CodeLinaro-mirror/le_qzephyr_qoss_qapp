## qcc730testing/tests/drivers/uart/uart_pinctrl_tests/testcase.yaml
```yaml
# Copyright (c) Qualcomm Technologies, Inc. and/or its subsidiaries.
# SPDX-License-Identifier: BSD-3-Clause-Clear

common:
  tags:
    - drivers
    - uart
    - pinctrl
  harness: ztest
  platform_allow: qcc730mi
  timeout: 60

tests:
  drivers.uart.qcc730.pinctrl_options:
    platform_allow:
      - qcc730mi
```

## qcc730testing/tests/drivers/uart/uart_pm_test/testcase.yaml
```yaml
# SPDX-License-Identifier: BSD-3-Clause-Clear
# Copyright (c) Qualcomm Technologies, Inc. and/or its subsidiaries.

common:
  tags:
    - drivers
    - uart
    - pm
  harness: ztest
  platform_allow: qcc730mi
  timeout: 60

tests:
  drivers.uart.qcc730.pm_api:
    platform_allow:
      - qcc730mi
```
