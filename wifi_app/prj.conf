## CMakeLists.txt
```
# Copyright (c) Qualcomm Technologies, Inc. and/or its subsidiaries.
# SPDX-License-Identifier: BSD-3-Clause

cmake_minimum_required(VERSION 3.20.0)

find_package(Zephyr REQUIRED HINTS $ENV{ZEPHYR_BASE})
project(wifi_app)

target_sources(app PRIVATE src/main.c)

# ===== Post-build: run Python script for hex/strip/bin/hashed =====
find_package(Python3 COMPONENTS Interpreter REQUIRED)

set(POST_PY "${ZEPHYR_HAL_QCOM_MODULE_DIR}/tools/post_process.py")
set(HASH_SCRIPT "${ZEPHYR_HAL_QCOM_MODULE_DIR}/tools/qhash/sechash/createxbl.py")
set(SBL_TOOL_PREFIX "${ZEPHYR_SDK_INSTALL_DIR}/arm-zephyr-eabi/bin/arm-zephyr-eabi")

set(APP_OUT_DIR "${APPLICATION_BINARY_DIR}/zephyr")
set(HASHED_ELF_BASENAME "zephyr_HASHED.elf")
set(HASHED_ELF "${APP_OUT_DIR}/${HASHED_ELF_BASENAME}")

# Use add_custom_command for incremental build support
add_custom_command(
  OUTPUT "${HASHED_ELF}"
  COMMAND "${Python3_EXECUTABLE}" "${POST_PY}"
          --elf "${APPLICATION_BINARY_DIR}/zephyr/zephyr.elf"
          --tool-prefix "${SBL_TOOL_PREFIX}"
          --hash-script "${HASH_SCRIPT}"
          --hashed-out "${HASHED_ELF}"
          --check-noinit
  DEPENDS zephyr_final "${APPLICATION_BINARY_DIR}/zephyr/zephyr.elf"
  COMMENT "Post-process ELF and generate hashed ELF"
  VERBATIM
)

# Use zephyr_final target which is created by Zephyr build system
add_custom_target(post_process_elf ALL DEPENDS "${HASHED_ELF}")

# ===== Signing support: Manual target "sign" =====
# Usage: west build -b qcc730mi -t sign
# This allows signing without rebuilding/reconfiguring the project

# Paths to sectools
set(SECTOOLS_DIR "${ZEPHYR_HAL_QCOM_MODULE_DIR}/tools/sectools")
set(SECTOOLS_SCRIPT "${SECTOOLS_DIR}/sectools.py")
set(SECTOOLS_CONFIG "${ZEPHYR_HAL_QCOM_MODULE_DIR}/tools/sectools/config/qcc730/qcc730_secimage.xml")

# Input ELF files
set(SBL_ELF "${APPLICATION_BINARY_DIR}/modules/hal_qcom/qboot/${BOARD}_sbl.elf")
set(APP_ELF "${APPLICATION_BINARY_DIR}/zephyr/zephyr.elf")

# Output directories
set(SBL_SIGNED_DIR "${APPLICATION_BINARY_DIR}/modules/hal_qcom/qboot/zephyr_sec_sbl")
set(APP_SIGNED_DIR "${APPLICATION_BINARY_DIR}/zephyr/zephyr_sec_app")

# Output files (based on sectools output structure)
set(SBL_SIGNED_BIN "${SBL_SIGNED_DIR}/qcc730/sbl/${BOARD}_sbl.elf")
set(APP_SIGNED_BIN "${APP_SIGNED_DIR}/qcc730/app/zephyr.elf")

# Sign SBL image custom command
add_custom_command(
  OUTPUT "${SBL_SIGNED_BIN}"
  COMMAND "${Python3_EXECUTABLE}" "${SECTOOLS_SCRIPT}"
          secimage
          -i "${SBL_ELF}"
          -c "${SECTOOLS_CONFIG}"
          -sa
          -g sbl
          -o "${SBL_SIGNED_DIR}"
  WORKING_DIRECTORY "${SECTOOLS_DIR}"
  DEPENDS "${SBL_ELF}"
  COMMENT "Signing SBL image with sectools"
  VERBATIM
)

# Sign application image custom command
add_custom_command(
  OUTPUT "${APP_SIGNED_BIN}"
  COMMAND "${Python3_EXECUTABLE}" "${SECTOOLS_SCRIPT}"
          secimage
          -i "${APP_ELF}"
          -c "${SECTOOLS_CONFIG}"
          -sa
          -g app
          -o "${APP_SIGNED_DIR}"
  WORKING_DIRECTORY "${SECTOOLS_DIR}"
  DEPENDS "${APP_ELF}"
  COMMENT "Signing application image with sectools"
  VERBATIM
)

# Define "sign" target that triggers signing
# NOT added to ALL, so it won't run by default
add_custom_target(sign
  DEPENDS "${SBL_SIGNED_BIN}" "${APP_SIGNED_BIN}"
  COMMAND ${CMAKE_COMMAND} -E echo "========================================================================"
  COMMAND ${CMAKE_COMMAND} -E echo "✓ Signing completed successfully!"
  COMMAND ${CMAKE_COMMAND} -E echo "========================================================================"
  COMMAND ${CMAKE_COMMAND} -E echo "Signed SBL:         ${SBL_SIGNED_DIR}"
  COMMAND ${CMAKE_COMMAND} -E echo "Signed Application: ${APP_SIGNED_DIR}"
  COMMAND ${CMAKE_COMMAND} -E echo "========================================================================"
  VERBATIM
)

# Ensure signing depends on ELF generation (if running in same build)
add_dependencies(sign post_process_elf)
```

## Kconfig
```
# Copyright (c) Qualcomm Technologies, Inc. and/or its subsidiaries.
# SPDX-License-Identifier: Apache-2.0;
menu "Zephyr"
source "Kconfig.zephyr"
endmenu

module = APP
module-str = Application
source "subsys/logging/Kconfig.template.log_config"
```

## prj.conf
```kconfig
# Copyright (c) Qualcomm Technologies, Inc. and/or its subsidiaries.
# SPDX-License-Identifier: BSD-3-Claus

# nothing here

CONFIG_MAIN_STACK_SIZE=2048

CONFIG_NETWORKING=y
CONFIG_NET_IPV4=y
CONFIG_NET_IPV6=y
CONFIG_NET_TCP=y
CONFIG_NET_UDP=y
CONFIG_NET_MGMT=y
CONFIG_NET_CONFIG_AUTO_INIT=n
CONFIG_ETH_DRIVER=n
CONFIG_TEST_RANDOM_GENERATOR=y
CONFIG_NET_L2_ETHERNET=y
CONFIG_NET_SHELL=y
# dhcp
CONFIG_NET_DHCPV4=y
CONFIG_NET_DHCPV4_SERVER=y
CONFIG_WIFI_QCOM_AUTO_DHCPV4=y

CONFIG_WIFI=y
CONFIG_WIFI_QCOM=y
CONFIG_NET_L2_WIFI_SHELL=y
CONFIG_NET_MGMT_EVENT_QUEUE_TIMEOUT=5000
CONFIG_NET_MGMT_EVENT_QUEUE_SIZE=16
CONFIG_NET_L2_WIFI_MGMT=y

CONFIG_NET_LOG=y
CONFIG_NET_L2_ETHERNET_LOG_LEVEL_DBG=n
CONFIG_NET_L2_WIFI_MGMT_LOG_LEVEL_DBG=y
CONFIG_NET_MGMT_EVENT_LOG_LEVEL_DBG=n
CONFIG_WIFI_LOG_LEVEL_DBG=y

# increase CONFIG_NET_BUF_DATA_SIZE to 512, allow more net buffer allocated.
CONFIG_NET_BUF_DATA_SIZE=512
# increase NET_MGMT_EVENT_STACK_SIZE to 1024, fix potential stack overflow issues.
CONFIG_NET_MGMT_EVENT_STACK_SIZE=1024
# increase SYSTEM_WORKQUEUE_STACK_SIZE to 2048, fix potential stack overflow issues.
CONFIG_SYSTEM_WORKQUEUE_STACK_SIZE=2048

# zperf
CONFIG_NET_ZPERF=y
CONFIG_NET_ZPERF_SERVER=y
# allow more ZVFS_POLL
CONFIG_ZVFS_POLL_MAX=16

CONFIG_NET_ZPERF_MAX_PACKET_SIZE=1500

CONFIG_FLASH=y
CONFIG_FLASH_QCC730=y
CONFIG_BOARD_QCC730_UART_GPIO_OPTION=1
CONFIG_PM_DEVICE=y

CONFIG_CODE_DATA_RELOCATION=y
CONFIG_DP_RAM_LOCATED=y

CONFIG_NET_PKT_TX_COUNT=40
CONFIG_NET_PKT_RX_COUNT=40
CONFIG_NET_BUF_TX_COUNT=40
CONFIG_NET_BUF_RX_COUNT=40
CONFIG_NET_BUF_DATA_SIZE=1500
CONFIG_NET_TCP_MAX_SEND_WINDOW_SIZE=30000
CONFIG_SYS_HEAP_RUNTIME_STATS=y
CONFIG_NET_BUF_POOL_USAGE=y

CONFIG_QCRYPTO=y
CONFIG_MBEDTLS=y
CONFIG_MBEDTLS_TEST=y

# Enable RING_SERVICE
#CONFIG_RING_SERVICE=y

# ============================================
# MCUmgr Configuration
# ============================================
# ZCBOR - required for MCUmgr
CONFIG_ZCBOR=y
CONFIG_ZCBOR_CANONICAL=y

# MCUmgr Core - basic MCUmgr support
CONFIG_MCUMGR=y

# ============================================
# Qualcomm Image Management
# ============================================
# Main switch - enables all required MCUmgr dependencies automatically
CONFIG_QCOM_IMG_MGMT=y
CONFIG_QCOM_IMG_MGMT_LOG_LEVEL_INF=y

# Override default Kconfig values if needed
CONFIG_QCOM_IMG_MGMT_ZCBOR_MAX_STR_LEN=1024
CONFIG_QCOM_IMG_MGMT_UDP_PORT=1337
CONFIG_QCOM_IMG_MGMT_UDP_MTU=1500
CONFIG_QCOM_IMG_MGMT_NETBUF_COUNT=4
CONFIG_QCOM_IMG_MGMT_NETBUF_SIZE=4096
CONFIG_QCOM_IMG_MGMT_SHA256_SUPPORT=y

# two wifi drv iface support
CONFIG_WIFI_NM=y
CONFIG_NET_IF_MAX_IPV6_COUNT=2
CONFIG_NET_IF_MAX_IPV4_COUNT=2
CONFIG_NET_IF_MCAST_IPV6_ADDR_COUNT=4
```

## src/main.c
```c
/*
 * Copyright (c) Qualcomm Technologies, Inc. and/or its subsidiaries.
 *
 * SPDX-License-Identifier: BSD-3-Clause
 */

#include <zephyr/shell/shell.h>
#include <zephyr/sys/util.h>
#include <stdio.h>
#include <stdlib.h>
#include <stdbool.h>

#include <zephyr/kernel.h>
#include <zephyr/logging/log.h>

LOG_MODULE_REGISTER(app, CONFIG_APP_LOG_LEVEL);

int main(void)
{
    k_sleep(K_MSEC(1));
    LOG_INF("Hello World! %s", CONFIG_BOARD_TARGET);
    
    return 0;
}
```
