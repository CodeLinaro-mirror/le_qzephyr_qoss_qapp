## CMakeLists.txt
```
# Copyright (c) Qualcomm Technologies, Inc. and/or its subsidiaries.
# SPDX-License-Identifier: BSD-3-Clause-Clear

cmake_minimum_required(VERSION 3.20.0)
find_package(Zephyr REQUIRED HINTS $ENV{ZEPHYR_BASE})
project(spi_test_app)

file(GLOB app_sources src/main.c)
target_sources(app PRIVATE ${app_sources})
```

## sample.yaml
```
# Copyright (c) Qualcomm Technologies, Inc. and/or its subsidiaries.
# SPDX-License-Identifier: BSD-3-Clause-Clear

sample:
  name: SPI test app
tests:
  sample.drivers.spi.spi_test_app:
    build_only: true
    platform_allow:
      - native_posix
    tags:
      - spi
      - serial
      - uart
```

## prj.conf
```kconfig
# Copyright (c) Qualcomm Technologies, Inc. and/or its subsidiaries.
# SPDX-License-Identifier: BSD-3-Clause-Clear

CONFIG_SERIAL=y
CONFIG_UART_USE_RUNTIME_CONFIGURE=y
CONFIG_PINCTRL=y
CONFIG_LOG=y
CONFIG_GPIO=y
CONFIG_SPI=y
CONFIG_SPI_ASYNC=y
CONFIG_SPI_QCC730=y
CONFIG_SPI_LOG_LEVEL_DBG=y
```

## boards/qcc730mi.overlay
```dts
/*
 * Copyright (c) Qualcomm Technologies, Inc. and/or its subsidiaries.
 *
 * SPDX-License-Identifier: BSD-3-Clause-Clear
 */

&gpioa {
    status = "okay";
};

&qcspi {
    status = "okay";
};
```

## src/main.c
```c
/*
 * Copyright (c) Qualcomm Technologies, Inc. and/or its subsidiaries.
 *
 * SPDX-License-Identifier: BSD-3-Clause-Clear
 */

#include <zephyr/kernel.h>
#include <zephyr/device.h>
#include <zephyr/drivers/uart.h>
#include <stdio.h>
#include <string.h>

const struct device *spi_dev = DEVICE_DT_GET(DT_NODELABEL(qcspi));

int main(void)
{
	if (!device_is_ready(spi_dev)) {
		printk("SPI device not ready\n");
		return -ENODEV;
	}

	printk("SPI slave verification app started\n");

	while (1) {
		k_sleep(K_MSEC(1));
	}

	return 0;
}
```
