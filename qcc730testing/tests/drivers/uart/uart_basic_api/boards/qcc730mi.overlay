&uart0 {
	pinctrl-0 = <&uart0_option1>;
	pinctrl-names = "default";
	status = "okay";
	current-speed = <115200>;
	parity = "none"; /* NONE */
	stop-bits = "1"; /* 1 stop bit */
	data-bits = <8>; /* 8 data bits */
};