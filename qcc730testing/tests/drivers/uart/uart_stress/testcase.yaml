## qcc730testing/tests/drivers/uart/uart_stress/testcase.yaml
```yaml
# SPDX-License-Identifier: BSD-3-Clause-Clear
# Copyright (c) Qualcomm Technologies, Inc. and/or its subsidiaries.

common:
  tags:
    - drivers
    - uart
  harness: ztest
  platform_allow: qcc730mi
  timeout: 180
tests:
  drivers.uart.qcc730.uart_stress_polling:
    platform_allow:
      - qcc730mi
```

## qcc730testing/tests/drivers/uart/uart_stress_pytest/testcase.yaml
```yaml
# SPDX-License-Identifier: BSD-3-Clause-Clear
# Copyright (c) Qualcomm Technologies, Inc. and/or its subsidiaries.

common:
  tags:
    - drivers
    - uart
tests:
  drivers.uart.stress.large_transfer:
    harness: pytest
    harness_config:
      pytest_root:
        - "pytest/test_uart_transfer.py"
    integration_platforms:
      - qcc730mi
    platform_allow: qcc730mi
    timeout: 3600
```
