## CMakeLists.txt
```
# Copyright (c) Qualcomm Technologies, Inc. and/or its subsidiaries.
# SPDX-License-Identifier: BSD-3-Clause-Clear

cmake_minimum_required(VERSION 3.20.0)

# Apply workspace patches before Zephyr loads Kconfig.
# Runs at CMake configure time; no-op if patches are already applied.
find_program(PYTHON_CMD NAMES python3 python)
if(PYTHON_CMD)
  get_filename_component(_patch_script
    "${CMAKE_CURRENT_SOURCE_DIR}/../patch/apply_patches.py" ABSOLUTE)
  execute_process(
    COMMAND "${PYTHON_CMD}" "${_patch_script}" apply
    WORKING_DIRECTORY "${CMAKE_CURRENT_SOURCE_DIR}"
    RESULT_VARIABLE _patch_result
  )
  if(NOT _patch_result EQUAL 0)
    message(FATAL_ERROR "apply_patches.py failed (exit ${_patch_result})")
  endif()
endif()

find_package(Zephyr REQUIRED HINTS $ENV{ZEPHYR_BASE})
project(ent_app)

target_sources(app PRIVATE src/main.c)

# ===== Post-build: run Python script for hex/strip/bin/hashed =====
find_package(Python3 COMPONENTS Interpreter REQUIRED)

set(POST_PY "${ZEPHYR_HAL_QCOM_MODULE_DIR}/tools/post_process.py")
set(HASH_SCRIPT "${ZEPHYR_HAL_QCOM_MODULE_DIR}/tools/qhash/sechash/createxbl.py")
set(SBL_TOOL_PREFIX "${ZEPHYR_SDK_INSTALL_DIR}/arm-zephyr-eabi/bin/arm-zephyr-eabi")

set(APP_OUT_DIR "${APPLICATION_BINARY_DIR}/zephyr")
set(HASHED_ELF_BASENAME "zephyr_HASHED.elf")
set(HASHED_ELF "${APP_OUT_DIR}/${HASHED_ELF_BASENAME}")

# Use add_custom_command for incremental build support
add_custom_command(
  OUTPUT "${HASHED_ELF}"
  COMMAND "${Python3_EXECUTABLE}" "${POST_PY}"
          --elf "${APPLICATION_BINARY_DIR}/zephyr/zephyr.elf"
          --tool-prefix "${SBL_TOOL_PREFIX}"
          --hash-script "${HASH_SCRIPT}"
          --hashed-out "${HASHED_ELF}"
          --check-noinit
  DEPENDS zephyr_final "${APPLICATION_BINARY_DIR}/zephyr/zephyr.elf"
  COMMENT "Post-process ELF and generate hashed ELF"
  VERBATIM
)

# Use zephyr_final target which is created by Zephyr build system
add_custom_target(post_process_elf ALL DEPENDS "${HASHED_ELF}")

# ===== Signing support: Manual target "sign" =====
# Usage: west build -b qcc730mi -t sign
# This allows signing without rebuilding/reconfiguring the project

# Paths to sectools
set(SECTOOLS_DIR "${ZEPHYR_HAL_QCOM_MODULE_DIR}/tools/sectools")
set(SECTOOLS_SCRIPT "${SECTOOLS_DIR}/sectools.py")
set(SECTOOLS_CONFIG "${ZEPHYR_HAL_QCOM_MODULE_DIR}/tools/sectools/config/qcc730/qcc730_secimage.xml")

# Input ELF files
set(SBL_ELF "${APPLICATION_BINARY_DIR}/modules/hal_qcom/qboot/${BOARD}_sbl.elf")
set(APP_ELF "${APPLICATION_BINARY_DIR}/zephyr/zephyr.elf")

# Output directories
set(SBL_SIGNED_DIR "${APPLICATION_BINARY_DIR}/modules/hal_qcom/qboot/zephyr_sec_sbl")
set(APP_SIGNED_DIR "${APPLICATION_BINARY_DIR}/zephyr/zephyr_sec_app")

# Output files (based on sectools output structure)
# Note: sectools creates subdirectories based on sign_id (-g parameter)
set(SBL_SIGNED_BIN "${SBL_SIGNED_DIR}/qcc730/sbl/${BOARD}_sbl.elf")
set(SBL_SIGNED_GOLDEN_BIN "${SBL_SIGNED_DIR}/qcc730/sbl_golden/${BOARD}_sbl.elf")
set(APP_SIGNED_BIN "${APP_SIGNED_DIR}/qcc730/app/zephyr.elf")
set(APP_SIGNED_GOLDEN_BIN "${APP_SIGNED_DIR}/qcc730/app_golden/zephyr.elf")

# Sign SBL image custom command
add_custom_command(
  OUTPUT "${SBL_SIGNED_GOLDEN_BIN}"
  COMMAND "${Python3_EXECUTABLE}" "${SECTOOLS_SCRIPT}"
          secimage
          -i "${SBL_ELF}"
          -c "${SECTOOLS_CONFIG}"
          -sa
          -g sbl_golden
          -o "${SBL_SIGNED_DIR}"
  WORKING_DIRECTORY "${SECTOOLS_DIR}"
  DEPENDS "${SBL_ELF}"
  COMMENT "Signing SBL image with sectools"
  VERBATIM
)

add_custom_command(
  OUTPUT "${SBL_SIGNED_BIN}"
  COMMAND "${Python3_EXECUTABLE}" "${SECTOOLS_SCRIPT}"
          secimage
          -i "${SBL_ELF}"
          -c "${SECTOOLS_CONFIG}"
          -sa
          -g sbl
          -o "${SBL_SIGNED_DIR}"
  WORKING_DIRECTORY "${SECTOOLS_DIR}"
  DEPENDS "${SBL_ELF}"
  COMMENT "Signing SBL image with sectools"
  VERBATIM
)

# Sign application image custom command
add_custom_command(
  OUTPUT "${APP_SIGNED_BIN}"
  COMMAND "${Python3_EXECUTABLE}" "${SECTOOLS_SCRIPT}"
          secimage
          -i "${APP_ELF}"
          -c "${SECTOOLS_CONFIG}"
          -sa
          -g app
          -o "${APP_SIGNED_DIR}"
  WORKING_DIRECTORY "${SECTOOLS_DIR}"
  DEPENDS "${APP_ELF}"
  COMMENT "Signing application image with sectools"
  VERBATIM
)

# Sign application golden image custom command
add_custom_command(
  OUTPUT "${APP_SIGNED_GOLDEN_BIN}"
  COMMAND "${Python3_EXECUTABLE}" "${SECTOOLS_SCRIPT}"
          secimage
          -i "${APP_ELF}"
          -c "${SECTOOLS_CONFIG}"
          -sa
          -g app_golden
          -o "${APP_SIGNED_DIR}"
  WORKING_DIRECTORY "${SECTOOLS_DIR}"
  DEPENDS "${APP_ELF}"
  COMMENT "Signing application golden image with sectools"
  VERBATIM
)

# Define "sign" target that triggers signing
# NOT added to ALL, so it won't run by default
add_custom_target(sign
  DEPENDS "${SBL_SIGNED_BIN}" "${SBL_SIGNED_GOLDEN_BIN}" "${APP_SIGNED_BIN}" "${APP_SIGNED_GOLDEN_BIN}"
  COMMAND ${CMAKE_COMMAND} -E echo "========================================================================"
  COMMAND ${CMAKE_COMMAND} -E echo "✓ Signing completed successfully!"
  COMMAND ${CMAKE_COMMAND} -E echo "========================================================================"
  COMMAND ${CMAKE_COMMAND} -E echo "Signed SBL:         ${SBL_SIGNED_DIR}"
  COMMAND ${CMAKE_COMMAND} -E echo "Signed Application: ${APP_SIGNED_DIR}"
  COMMAND ${CMAKE_COMMAND} -E echo "========================================================================"
  VERBATIM
)

# Ensure signing depends on ELF generation (if running in same build)
add_dependencies(sign post_process_elf)
```

## sample.yaml
```
sample:
  description: Qcom ent app
    application
  name: ent app
common:
  tags: introduction
  harness: console
```

## prj.conf
```kconfig
# Copyright (c) Qualcomm Technologies, Inc. and/or its subsidiaries.
# SPDX-License-Identifier: BSD-3-Clause-Clear

# nothing here

# ISR stack overflow fix: PEAP/TTLS measured 3104 bytes; EAP-TLS (RSA-2048 cert verify) needs more.
# 4096 sufficient for PEAP/TTLS but overflows on EAP-TLS (MLME Halt + shell hung).
# 6144 = ~2x PEAP peak, leaves 2KB margin for EAP-TLS RSA path vs 8192.
CONFIG_ISR_STACK_SIZE=6144
CONFIG_MAIN_STACK_SIZE=4096

CONFIG_NET_IPV6_FRAGMENT_MAX_COUNT=4
CONFIG_NET_IPV6_FRAGMENT_MAX_PKT=4
CONFIG_NET_IPV6_FRAGMENT_TIMEOUT=5
CONFIG_NETWORKING=y
CONFIG_NET_IPV4=y
CONFIG_NET_IPV6=y
CONFIG_NET_TCP=y
CONFIG_NET_UDP=y
CONFIG_NET_SOCKETS=y
CONFIG_NET_MGMT=y
CONFIG_NET_CONFIG_AUTO_INIT=n
CONFIG_ETH_DRIVER=n
CONFIG_TEST_RANDOM_GENERATOR=y
CONFIG_NET_L2_ETHERNET=y
CONFIG_NET_SHELL=y
# dhcp
CONFIG_NET_DHCPV4=y
CONFIG_NET_DHCPV4_SERVER=y
CONFIG_WIFI_QCOM_AUTO_DHCPV4=y
CONFIG_NET_DHCPV4_INITIAL_DELAY_MAX=2

CONFIG_WIFI=y
CONFIG_WIFI_QCOM=y
CONFIG_NET_L2_WIFI_SHELL=y
CONFIG_NET_MGMT_EVENT_QUEUE_TIMEOUT=5000
CONFIG_NET_MGMT_EVENT_QUEUE_SIZE=16
CONFIG_NET_L2_WIFI_MGMT=y

CONFIG_NET_LOG=y
CONFIG_NET_L2_ETHERNET_LOG_LEVEL_DBG=n
CONFIG_NET_L2_WIFI_MGMT_LOG_LEVEL_DBG=y
CONFIG_NET_MGMT_EVENT_LOG_LEVEL_DBG=n
CONFIG_WIFI_LOG_LEVEL_DBG=y

# increase CONFIG_NET_BUF_DATA_SIZE to 512, allow more net buffer allocated.
CONFIG_NET_BUF_DATA_SIZE=512
# increase NET_MGMT_EVENT_STACK_SIZE to 1024, fix potential stack overflow issues.
CONFIG_NET_MGMT_EVENT_STACK_SIZE=1024
# increase SYSTEM_WORKQUEUE_STACK_SIZE to 2048, fix potential stack overflow issues.
CONFIG_SYSTEM_WORKQUEUE_STACK_SIZE=2048

# zperf
CONFIG_NET_ZPERF=y
CONFIG_NET_ZPERF_SERVER=y
# allow more ZVFS_POLL
CONFIG_ZVFS_POLL_MAX=16
# increase ZPERF work queue priority will increase TCP tx tput, but decrease UDP tx tput
# CONFIG_ZPERF_WORK_Q_THREAD_PRIORITY=7

#power
CONFIG_PM=y
CONFIG_STATS=y
CONFIG_PM_STATS=y

# counter driver.
CONFIG_COUNTER=y

# RTC driver
CONFIG_RTC=y
CONFIG_RTC_QCC730=y
# RTC shell
CONFIG_RTC_SHELL=y

CONFIG_WIFI_TSF_RTC_CORRECTION=y

# avoid stack overflow in the idle task thread.
CONFIG_IDLE_STACK_SIZE=1024

# enable SEGGER RTT
#CONFIG_UART_CONSOLE=n
#CONFIG_RTT_CONSOLE=y
#CONFIG_USE_SEGGER_RTT=y
#CONFIG_SHELL_BACKEND_SERIAL=n
#CONFIG_SHELL_BACKEND_RTT=y

# Crash dump configuration of two backend options:
# 1) Logging backend:
#    # CONFIG_DEBUG_COREDUMP=y
#    # CONFIG_DEBUG_COREDUMP_BACKEND_LOGGING=y
# 2) Flash partition backend:
#    # CONFIG_DEBUG_COREDUMP=y
#    # CONFIG_DEBUG_COREDUMP_BACKEND_FLASH_PARTITION=y
#    # CONFIG_DEBUG_COREDUMP_SHELL=y
#    # CONFIG_FLASH=y
#    # CONFIG_FLASH_MAP=y
#    # CONFIG_FLASH_PAGE_LAYOUT=y

CONFIG_NET_ZPERF_MAX_PACKET_SIZE=1500

CONFIG_FLASH=y
CONFIG_FLASH_QCC730=y
CONFIG_FLASH_MAP=y
CONFIG_FILE_SYSTEM=y
CONFIG_FILE_SYSTEM_LITTLEFS=y
CONFIG_WIFI_SHELL_RUNTIME_CERTIFICATES=y
CONFIG_BOARD_QCC730_UART_GPIO_OPTION=1
CONFIG_PM_DEVICE=y

CONFIG_GPIO=y
CONFIG_GPIO_SHELL=y

CONFIG_QCRYPTO=y
CONFIG_MBEDTLS=y
CONFIG_MBEDTLS_TEST=n

CONFIG_CODE_DATA_RELOCATION=y
CONFIG_DP_RAM_LOCATED=y

# Reduced from 40→20 (Build 29, freed ~60KB BSS).
# Attempted 20→16 (Build 45) but qapi_WLAN_Enable() blocks indefinitely with 16 bufs
# (Zephyr net msg queue event delivery fails → WiFi interface never registers).
# Reverted to 20. Use SSL_MAX_CONTENT_LEN=5120 instead to free runtime mbedTLS heap.
CONFIG_NET_PKT_TX_COUNT=40
CONFIG_NET_PKT_RX_COUNT=40
CONFIG_NET_BUF_TX_COUNT=40
CONFIG_NET_BUF_RX_COUNT=40
CONFIG_NET_BUF_DATA_SIZE=1536
CONFIG_NET_TCP_MAX_SEND_WINDOW_SIZE=20000
CONFIG_SYS_HEAP_RUNTIME_STATS=y
CONFIG_NET_BUF_POOL_USAGE=y
CONFIG_NET_DISABLE_ICMP_DESTINATION_UNREACHABLE=y
#increase TCP_RETRY_COUNT from 9 to 20 for noisy environment
CONFIG_NET_TCP_RETRY_COUNT=20
# disable TCP fast retransmit and increase init RTO, enable it when run multiple traffic at noisy environment
# CONFIG_NET_TCP_FAST_RETRANSMIT=n
# CONFIG_NET_TCP_INIT_RETRANSMISSION_TIMEOUT=4000

# enable RX thread schedule, disable by default
# CONFIG_NET_TC_THREAD_PREEMPTIVE=y
# CONFIG_NET_TC_THREAD_PRIO_CUSTOM=y
# CONFIG_NET_TC_RX_THREAD_BASE_PRIO=6


# Optimize for speed - required for WiFi throughput performance
# Note: Increases 50KB code size, verified to fit within QCC730 constraints
CONFIG_SPEED_OPTIMIZATIONS=y



# ============================================
# MCUmgr Configuration
# ============================================
# ZCBOR - required for MCUmgr
CONFIG_ZCBOR=n
CONFIG_ZCBOR_CANONICAL=n

# MCUmgr Core - basic MCUmgr support
CONFIG_MCUMGR=n

# ============================================
# Qualcomm Image Management (OTA firmware update via UDP)
# ============================================
# Disabled because CONFIG_MCUMGR=n above (RAM budget). Re-enable both
# together to restore OTA. Do NOT raise the NETBUF values: the tuning
# below is derived from an earlier regression.
#
# Reduced from 4x4096=16KB -> 2x2048=4KB to recover 12KB system RAM.
# MTU=1500 fits in 2048B buffers; COUNT=2 sufficient for OTA sequential transfers.
# (Build 50: 18KB mbedTLS heap + old 16KB MCUmgr -> nt_dpm starvation ->
#  hal_ret=17 EAPOL TX fail)
#
# CONFIG_QCOM_IMG_MGMT=y
# CONFIG_QCOM_IMG_MGMT_LOG_LEVEL_INF=y
# CONFIG_QCOM_IMG_MGMT_ZCBOR_MAX_STR_LEN=1024
# CONFIG_QCOM_IMG_MGMT_UDP_PORT=1337
# CONFIG_QCOM_IMG_MGMT_UDP_MTU=1500
# CONFIG_QCOM_IMG_MGMT_NETBUF_COUNT=2
# CONFIG_QCOM_IMG_MGMT_NETBUF_SIZE=2048
# CONFIG_QCOM_IMG_MGMT_SHA256_SUPPORT=y

# ============================================
# Qualcomm Watchdog Config
# ============================================
# Always enabled to ensure watchdog code is compiled
CONFIG_WATCHDOG=y
# Enable watchdog functionality
# CONFIG_QWDT=y
# CONFIG_WATCH_DOG_BITE_TIME=8

# Enable runtime NMI for watchdog bark handling
# CONFIG_RUNTIME_NMI=y

# secure storage configuration
#CONFIG_MBEDTLS_PSA_CRYPTO_C=y
#CONFIG_SECURE_STORAGE=y
#CONFIG_SECURE_STORAGE_ITS_IMPLEMENTATION_ZEPHYR=y
#CONFIG_SECURE_STORAGE_ITS_STORE_MODULE=y
#CONFIG_SECURE_STORAGE_ITS_TRANSFORM_AEAD_SCHEME_CUSTOM=y
#CONFIG_SECURE_STORAGE_ITS_TRANSFORM_AEAD_KEY_PROVIDER_CUSTOM=y
#CONFIG_ZMS=y
#CONFIG_SECURE_STORAGE_ITS_STORE_IMPLEMENTATION_ZMS=y
#CONFIG_PSA_WANT_ALG_CCM=y
#CONFIG_PSA_WANT_KEY_TYPE_AES=y
#CONFIG_SECURE_STORAGE_ITS_MAX_DATA_SIZE=2000

# two wifi drv iface support
CONFIG_WIFI_NM=y
CONFIG_NET_IF_MAX_IPV6_COUNT=2
CONFIG_NET_IF_MAX_IPV4_COUNT=2
CONFIG_NET_IF_MCAST_IPV6_ADDR_COUNT=4

# enable fragmentation for IPv6 zperf
CONFIG_NET_IPV6_FRAGMENT=y

# support multiple tx streams at the same time
#CONFIG_ZPERF_SESSION_PER_THREAD=y

# ============================================
# WPA2 Enterprise (802.1X/EAP) support
# ============================================
# 1. wpa_supplicant core (EAP state machine, EAPOL TX/RX)
CONFIG_WIFI_NM_WPA_SUPPLICANT=y
CONFIG_WIFI_NM_WPA_SUPPLICANT_CLI=y
# Optimization P0-1: remove wpa_printf format strings from rodata (~50-70 KB flash)
CONFIG_WIFI_NM_WPA_SUPPLICANT_NO_DEBUG=y

# Optimization P0-2: exclude TLS server code (client-only device) (~4 KB flash)
CONFIG_MBEDTLS_SSL_SRV_C=n

# 2. QCC730 Enterprise glue layer (EAPOL RX demux, EVENT_ASSOC injection, maxStart=0)
CONFIG_WIFI_QCOM_ENTERPRISE=y

# 3. Enterprise EAP methods + TLS 1.2 + certificate library (selects MBEDTLS_SSL_PROTO_TLS1_2, WIFI_CERTIFICATE_LIB)
CONFIG_WIFI_NM_WPA_SUPPLICANT_CRYPTO_ENTERPRISE=y

# 4. mbedTLS ALT backend (interfaces with libcryptoqcc730.a; default CRYPTO_BACKEND choice, declared explicitly to avoid ambiguity)
CONFIG_WIFI_NM_WPA_SUPPLICANT_CRYPTO_ALT=y

# 5. TLS 1.2 (hard dependency for EAP-PEAP/TTLS outer tunnel; already selected by CRYPTO_ENTERPRISE, kept explicit here)
CONFIG_MBEDTLS_SSL_PROTO_TLS1_2=y

# 9. Disable advanced Wi-Fi features not needed for enterprise EAP authentication.
#    QCC730 firmware handles all MAC-layer QoS, roaming, and radio management.
#    Without this, ADVANCED_FEATURES defaults to y and pulls in:
#      robust_av.c (99.7 KB), wmm_ac.c (64.4 KB), wnm_sta.c (94.4 KB),
#      rrm.c (87.3 KB), op_classes.c (50.3 KB), mbo.c (66.6 KB) → ~463 KB total
CONFIG_WIFI_NM_WPA_SUPPLICANT_ADVANCED_FEATURES=n

# 10. Use only EAP methods required by our test matrix:
#     TC-02/05: EAP-PEAP/MSCHAPv2, TC-03/14: EAP-TTLS/MSCHAPv2, TC-06/07: EAP-TLS
#     EAP_ALL default-y also includes EAP_GTC (~10 KB) which we never use; disable it.
CONFIG_EAP_ALL=n
CONFIG_EAP_TLS=y
CONFIG_EAP_PEAP=y
CONFIG_EAP_TTLS=y
CONFIG_EAP_MSCHAPV2=y

# 5a. mbedTLS crypto algorithms required by EAP-TLS/PEAP/TTLS:
#     - ECDHE_RSA/ECDHE_ECDSA cipher suites for TLS handshake
#     - RSA for server cert verification (RSA-2048 on RADIUS server)
#     - MD5/SHA384 for MSCHAPv2 inner auth and PEAP inner tunnel
#     - CMAC for AES-CMAC in EAP key derivation
#     - DHM for DHE-RSA cipher suites (fallback if ECDHE unavailable)
#CONFIG_MBEDTLS_CIPHER_MODE_CTR_ENABLED=y
CONFIG_MBEDTLS_MD5=y
#CONFIG_MBEDTLS_SHA384=y
# ECP curves controlled by P3-3 optimization below (ECP_ALL=n, only secp256r1)
CONFIG_MBEDTLS_CMAC=y
CONFIG_MBEDTLS_PK_WRITE_C=y
CONFIG_MBEDTLS_ECDH_C=y
CONFIG_MBEDTLS_ECDSA_C=y
CONFIG_MBEDTLS_RSA_C=y
CONFIG_MBEDTLS_PKCS1_V15=y
CONFIG_MBEDTLS_PKCS1_V21=y
#CONFIG_MBEDTLS_KEY_EXCHANGE_ECDHE_PSK_ENABLED=y
CONFIG_MBEDTLS_KEY_EXCHANGE_ECDHE_RSA_ENABLED=y
#CONFIG_MBEDTLS_KEY_EXCHANGE_ECDHE_ECDSA_ENABLED=y
CONFIG_MBEDTLS_DHM_C=y

# 6. mbedTLS heap configuration.
#
#    DEDICATED HEAP HISTORY (builds 46-50) — do not re-enable without careful analysis:
#    Build 46 (heap=18000, 5120): RSA verify PASSES but TLS Finished rejected (wrong master_secret).
#    Build 47 (heap=18000, 6144): RSA-3072 MPI_ALLOC_FAILED → fatal:decrypt_error.
#    Build 48 (heap=19000, 6144): WiFi init blocks — only 580B RAM free.
#    Build 50 (heap=18000, 6144, MCUmgr 4KB): TLS stalls at Server Certificate —
#      silent ALLOC_FAILED mid-handshake. Peak mbedTLS need = SSL buffers(12KB) +
#      handshake struct(5KB) + x509 cert(3KB) + RSA-2048 MPI(2KB) = ~22KB > 18KB.
#
#    CURRENT APPROACH: MBEDTLS_ENABLE_HEAP=n (Zephyr system heap).
#    CRITICAL — DO NOT change to y: QCC730 RSA alt blob pre-initializes ctx->RN.p
#    to a static buffer (not mbedtls_calloc'd). When ENABLE_HEAP=y, the dedicated
#    pool allocator calls mbedtls_free() on that static pointer → HardFault double
#    fault at boot (completely silent, 0 bytes on serial). Confirmed by Build 51.
#    k_free() (system heap) handles arbitrary pointers safely.
#    System heap (~60KB after stacks) gives plenty of headroom for mbedTLS ~22KB peak.
#    NOTE: Do NOT reduce SSL_MAX_CONTENT_LEN below 6144.
#    NOTE: Do NOT switch RADIUS back to RSA-3072.
CONFIG_MBEDTLS_ENABLE_HEAP=n
#
# TLS IN/OUT record buffers: 6144 bytes (minimum working value for all EAP types).
# NOTE: Do NOT reduce below 6144 — 5120 causes wrong master_secret → TLS Finished rejected.
CONFIG_MBEDTLS_SSL_MAX_CONTENT_LEN=6144

# 7. Disable interface monitor: prevents race between wpa_supplicant interface thread
#    and QCC730 driver initialization that would cause EAPOL events to be lost
CONFIG_WIFI_NM_WPA_SUPPLICANT_INF_MON=n

# 8. Disable WPA3/SAE on wpa_supplicant side: QCC730 firmware already implements SAE;
#    compiling both sides causes symbol conflicts
CONFIG_WIFI_NM_WPA_SUPPLICANT_WPA3=n

# Lower wpa_supplicant thread priority so QURT tasks (WLAN MAC, data_path) can run.
# Default priority 0 (highest) starves all QURT tasks and fills WLAN message queue.
CONFIG_WIFI_NM_WPA_SUPPLICANT_PRIO=10

# Increase stack for wpa_supplicant thread: mbedTLS X.509 cert parsing during
# EAP-PEAP TLS handshake needs more than the default 8192 bytes (stack overflow
# at handshake state=2 confirmed by USAGE FAULT at PC inside noinit/stack area).
# 16384 not enough either: BUS FAULT at state=9 (TLS Finished / PEAP inner auth)
# with BFAR=0x380000 (stack guard). 32768 borderline: Build 22 succeeded once,
# Build 23 crashed again at state=9 with USAGE FAULT (non-deterministic overflow
# — r0/lr/r4/r5/r10=0x36363636 indicates corrupted stack frame).
# 40960 (40 KB) still non-deterministic: Build 24/25 passed state=9 (stalled at
# state=12); Build 26 crashed at state=9 with BUS FAULT BFAR=0xa0000 (corrupted
# heap pointer dereferenced into flash — deeper cert-verify call path).
# 49152 (48 KB) caused OOM at state=4 with net_buf=40 (heap ~27KB too small for RSA).
# 45056 (44 KB): stable in Build 29 (net_buf=20, heap=97KB). BUT Build 30 added 5
# local variables to qwifi_drv_send (~16 bytes extra frame in EAPOL TX call chain),
# tipping state=9 over → BUS FAULT BFAR=0xa0000. Stack margin was <16 bytes.
# 49152 (48 KB): safe again with net_buf=20 → heap ~93KB (97KB - 4KB BSS delta).
# RSA at state=4 needs ~23KB; 93KB leaves 70KB headroom.  Build 31.
# WPA3-ENT type 21 passed at 49152 (Build 36), but WPA2-ENT type 12 crashes at
# state=9 with PSP=0 (full stack exhaustion) — ieee80211w=0 path uses slightly
# more stack depth (EAPOL/RSN path diverges). Increased to 65536 (64 KB).
# Heap impact: -16KB → heap ~77KB; still 54KB headroom for 23KB RSA need.
# EAP-TLS state=3 (SERVER_CERTIFICATE, RSA 3072-bit) crashes at 65536 with
# USAGE FAULT PC=0x0 LR=0x0 (stack overflow: thread frame corrupted).
# Increased to 81920 (80 KB) to give EAP-TLS cert verification headroom.
# Heap impact: -16KB → heap ~61KB; still 38KB headroom for 23KB RSA need.
#
# Build 51 (2026-05-16): Attempted 49152 and 65536 with step-loop in tls_mbedtls_alt.c.
# Both fail silently at state=3 (SERVER_KEY_EXCHANGE: ECDHE + RSA-2048 signature verify).
# step_done state=2->3 ret=0 is printed, but state=3 step never returns — no USAGE FAULT,
# no stack sentinel, silent hang. Reverted to 81920 (80 KB). The step-loop reduces peak
# TOTAL depth (no need to hold all states simultaneously), but the deepest single state
# (state=3: RSA-2048 verify + ECDHE key ops) still exceeds 64KB alone.
# Minimum safe stack for EAP-TLS with RSA-2048 + ECDHE: >64KB, ≤80KB.
# (Stack reduction goal abandoned for now — need profiling to find actual minimum.)
# Optimization P1-1: reduce supplicant thread stack 80KB→64KB (-16KB RAM)
# EAP-TLS (deepest path) tested at 64KB - if TC_WPA3_003 regresses, revert.
#
# Optimization P1-2 (2026-07-31): -fstack-usage + CONFIG_THREAD_STACK_INFO
# measurement on current build (HW PKA RSA via rsa_alt.c, HW ECP via ecp_alt.c)
# shows hostap_handler peaks at only 4956/65536 bytes (7%) after a full
# EAP-TLS handshake (TLS states 0->27 incl. cert verify). The historical
# 64KB->80KB crashes above predate/differ from this HW-offload build (pure
# software RSA/ECC MPI paths would need far more). Verified 16384 (16KB,
# ~3.3x observed peak) passes TC_WPA3_001-016 (full 16-case regression, all
# 3 AP modes) with CONFIG_STACK_SENTINEL=y active as a safety net.
#
# Optimization P1-3 (2026-07-31): trying 8192 (8KB, ~1.65x observed 4956B
# peak) — much thinner margin than 16KB. CONFIG_STACK_SENTINEL=y will catch
# an overflow as a clean thread-name fault instead of silent corruption if
# this is too tight. Revert to 16384 if TC001-016 regress.
CONFIG_WIFI_NM_WPA_SUPPLICANT_THREAD_STACK_SIZE=8192
# shell_uart thread overflows at 2048 when processing "wifi connect -k 7"
# (wifi_set_enterprise_credentials call chain depth).  Increase to 8192.
# Still overflowing at 4096 (~4.7KB usage measured at arch_swap detection point).
CONFIG_SHELL_STACK_SIZE=8192
# Enable stack sentinel to detect overflow: prints thread name instead of USAGE FAULT
CONFIG_STACK_SENTINEL=y

# Optimization P2: fullmac mode excludes scan.c/sme.c/bss.c/ctrl_iface.c/ctrl_iface_zephyr.c
# wpa_cli_cmds.c/wpa_cli_zephyr.c from the build (~75 KB flash).
CONFIG_WIFI_NM_WPA_SUPPLICANT_FULLMAC=y

# Optimization P3-1 (CRL): tls_mbedtls_alt.c uses mbedtls_x509_crl_* in 10+ places
# without #ifdef guards; guarding them requires invasive source changes for only ~2.2 KB.
# Skipped — not worth the maintenance burden.

# Optimization P3-2: NIST Key Wrap skipped — libwifiqcc730.a calls mbedtls_nist_kw_*;
# cannot remove without breaking the prebuilt blob.

# Optimization P3-3: keep only P-256 (secp256r1) for enterprise TLS ECDHE.
# All 5 test cases use AKM5 (WPA-EAP-SHA256, -k 21) or WPA2-Enterprise (-k 12);
# none use Suite B 192-bit (AKM12) which would require P-384.
# Savings: ~8-12 KB flash (ecp_curves constant tables for 13 removed curves).
# Note: removed "select MBEDTLS_ECP_ALL_ENABLED" from WIFI_NM_WPA_SUPPLICANT_CRYPTO_ALT
# in zephyr/modules/hostap/Kconfig for this to take effect.
CONFIG_MBEDTLS_ECP_ALL_ENABLED=n
CONFIG_MBEDTLS_ECP_DP_SECP256R1_ENABLED=y

# Optimization P3-D: FULLMAC build loads certs via LFS ("wifi load_certs /lfs"),
# not via Zephyr TLS credential shell API; this heap pool is never used.
# Gated on FULLMAC: non-FULLMAC builds that use shell cert loading must NOT set this.
CONFIG_HEAP_MEM_POOL_ADD_SIZE_TLS_CRED_SHELL=0
```

## qcc730evbi.overlay
```dts
/*
 * Copyright (c) Qualcomm Technologies, Inc. and/or its subsidiaries.
 * SPDX-License-Identifier: BSD-3-Clause-Clear
 *
 * Board overlay for qcc730evbi: add a LittleFS cert partition on external QSPI
 * NOR flash (qspi_nor_flash2, GD25WQ32E 4 MB) at offset 0x3000, size 64 KB.
 *
 * This file is auto-included by the Zephyr build system for the qcc730evbi
 * board when building ent_app.
 */

&qspi_nor_flash2 {
	status = "okay";
	partitions {
		compatible = "fixed-partitions";
		#address-cells = <1>;
		#size-cells = <1>;

		cert_partition: cert@3000 {
			label = "cert";
			reg = <0x3000 0x10000>; /* 64 KB at offset 0x3000 */
		};
	};
};
```

## qcc730evbx.overlay
```dts
/*
 * Copyright (c) Qualcomm Technologies, Inc. and/or its subsidiaries.
 * SPDX-License-Identifier: BSD-3-Clause-Clear
 *
 * Board overlay for qcc730evbx: add a LittleFS cert partition on external QSPI
 * NOR flash (qspi_nor_flash2, GD25WQ32E 4 MB) at offset 0x3000, size 64 KB.
 *
 * This file is auto-included by the Zephyr build system for the qcc730evbx
 * board when building ent_app.
 */

&qspi_nor_flash2 {
	status = "okay";
	partitions {
		compatible = "fixed-partitions";
		#address-cells = <1>;
		#size-cells = <1>;

		cert_partition: cert@3000 {
			label = "cert";
			reg = <0x3000 0x10000>; /* 64 KB at offset 0x3000 */
		};
	};
};
```

## qcc730mi.overlay
```dts
/*
 * Copyright (c) Qualcomm Technologies, Inc. and/or its subsidiaries.
 * SPDX-License-Identifier: BSD-3-Clause-Clear
 *
 * Board overlay for qcc730mi: add a LittleFS cert partition on external QSPI
 * NOR flash (qspi_nor_flash3, GT25Q32AU 4 MB) at offset 0x3000, size 64 KB.
 *
 * This file is auto-included by the Zephyr build system for the qcc730mi
 * board when building ent_app.
 */

&qspi_nor_flash3 {
	status = "okay";
	partitions {
		compatible = "fixed-partitions";
		#address-cells = <1>;
		#size-cells = <1>;

		cert_partition: cert@3000 {
			label = "cert";
			reg = <0x3000 0x10000>; /* 64 KB at offset 0x3000 */
		};
	};
};
```

## qcc730mx.overlay
```dts
/*
 * Copyright (c) Qualcomm Technologies, Inc. and/or its subsidiaries.
 * SPDX-License-Identifier: BSD-3-Clause-Clear
 *
 * Board overlay for qcc730mx: add a LittleFS cert partition on external QSPI
 * NOR flash (qspi_nor_flash3, GT25Q32AU 4 MB) at offset 0x3000, size 64 KB.
 *
 * This file is auto-included by the Zephyr build system for the qcc730mx
 * board when building ent_app.
 */

&qspi_nor_flash3 {
	status = "okay";
	partitions {
		compatible = "fixed-partitions";
		#address-cells = <1>;
		#size-cells = <1>;

		cert_partition: cert@3000 {
			label = "cert";
			reg = <0x3000 0x10000>; /* 64 KB at offset 0x3000 */
		};
	};
};
```

## src/main.c
```c
/*
 * Copyright (c) Qualcomm Technologies, Inc. and/or its subsidiaries.
 *
 * SPDX-License-Identifier: BSD-3-Clause-Clear
 */

#include <zephyr/shell/shell.h>
#include <zephyr/sys/util.h>
#include <stdio.h>
#include <stdlib.h>
#include <stdbool.h>

#include <zephyr/kernel.h>
#include <zephyr/logging/log.h>

LOG_MODULE_REGISTER(app, CONFIG_APP_LOG_LEVEL);

int main(void)
{
    k_sleep(K_MSEC(1));
    LOG_INF("Hello World! %s", CONFIG_BOARD_TARGET);
    
    return 0;
}
```
