## CMakeLists.txt
```
# Copyright (c) Qualcomm Technologies, Inc. and/or its subsidiaries.
# SPDX-License-Identifier: BSD-3-Clause-Clear

cmake_minimum_required(VERSION 3.20.0)

find_package(Zephyr REQUIRED HINTS $ENV{ZEPHYR_BASE})
project(wifi_app)

target_sources(app PRIVATE src/main.c)

# ===== Post-build: run Python script for hex/strip/bin/hashed =====
find_package(Python3 COMPONENTS Interpreter REQUIRED)

set(POST_PY "${ZEPHYR_HAL_QCOM_MODULE_DIR}/tools/post_process.py")
set(HASH_SCRIPT "${ZEPHYR_HAL_QCOM_MODULE_DIR}/tools/qhash/sechash/createxbl.py")
set(SBL_TOOL_PREFIX "${ZEPHYR_SDK_INSTALL_DIR}/arm-zephyr-eabi/bin/arm-zephyr-eabi")

set(APP_OUT_DIR "${APPLICATION_BINARY_DIR}/zephyr")
set(HASHED_ELF_BASENAME "zephyr_HASHED.elf")
set(HASHED_ELF "${APP_OUT_DIR}/${HASHED_ELF_BASENAME}")

# Use add_custom_command for incremental build support
add_custom_command(
  OUTPUT "${HASHED_ELF}"
  COMMAND "${Python3_EXECUTABLE}" "${POST_PY}"
          --elf "${APPLICATION_BINARY_DIR}/zephyr/zephyr.elf"
          --tool-prefix "${SBL_TOOL_PREFIX}"
          --hash-script "${HASH_SCRIPT}"
          --hashed-out "${HASHED_ELF}"
          --check-noinit
  DEPENDS zephyr_final "${APPLICATION_BINARY_DIR}/zephyr/zephyr.elf"
  COMMENT "Post-process ELF and generate hashed ELF"
  VERBATIM
)

# Use zephyr_final target which is created by Zephyr build system
add_custom_target(post_process_elf ALL DEPENDS "${HASHED_ELF}")

# ===== Signing support: Manual target "sign" =====
# Usage: west build -b qcc730mi -t sign
# This allows signing without rebuilding/reconfiguring the project

# Paths to sectools
set(SECTOOLS_DIR "${ZEPHYR_HAL_QCOM_MODULE_DIR}/tools/sectools")
set(SECTOOLS_SCRIPT "${SECTOOLS_DIR}/sectools.py")
set(SECTOOLS_CONFIG "${ZEPHYR_HAL_QCOM_MODULE_DIR}/tools/sectools/config/qcc730/qcc730_secimage.xml")

# Input ELF files
set(SBL_ELF "${APPLICATION_BINARY_DIR}/modules/hal_qcom/qboot/${BOARD}_sbl.elf")
set(APP_ELF "${APPLICATION_BINARY_DIR}/zephyr/zephyr.elf")

# Output directories
set(SBL_SIGNED_DIR "${APPLICATION_BINARY_DIR}/modules/hal_qcom/qboot/zephyr_sec_sbl")
set(APP_SIGNED_DIR "${APPLICATION_BINARY_DIR}/zephyr/zephyr_sec_app")

# Output files (based on sectools output structure)
set(SBL_SIGNED_BIN "${SBL_SIGNED_DIR}/qcc730/sbl/${BOARD}_sbl.elf")
set(APP_SIGNED_BIN "${APP_SIGNED_DIR}/qcc730/app/zephyr.elf")

# Sign SBL image custom command
add_custom_command(
  OUTPUT "${SBL_SIGNED_BIN}"
  COMMAND "${Python3_EXECUTABLE}" "${SECTOOLS_SCRIPT}"
          secimage
          -i "${SBL_ELF}"
          -c "${SECTOOLS_CONFIG}"
          -sa
          -g sbl
          -o "${SBL_SIGNED_DIR}"
  WORKING_DIRECTORY "${SECTOOLS_DIR}"
  DEPENDS "${SBL_ELF}"
  COMMENT "Signing SBL image with sectools"
  VERBATIM
)

# Sign application image custom command
add_custom_command(
  OUTPUT "${APP_SIGNED_BIN}"
  COMMAND "${Python3_EXECUTABLE}" "${SECTOOLS_SCRIPT}"
          secimage
          -i "${APP_ELF}"
          -c "${SECTOOLS_CONFIG}"
          -sa
          -g app
          -o "${APP_SIGNED_DIR}"
  WORKING_DIRECTORY "${SECTOOLS_DIR}"
  DEPENDS "${APP_ELF}"
  COMMENT "Signing application image with sectools"
  VERBATIM
)

# Define "sign" target that triggers signing
# NOT added to ALL, so it won't run by default
add_custom_target(sign
  DEPENDS "${SBL_SIGNED_BIN}" "${APP_SIGNED_BIN}"
  COMMAND ${CMAKE_COMMAND} -E echo "========================================================================"
  COMMAND ${CMAKE_COMMAND} -E echo "✓ Signing completed successfully!"
  COMMAND ${CMAKE_COMMAND} -E echo "========================================================================"
  COMMAND ${CMAKE_COMMAND} -E echo "Signed SBL:         ${SBL_SIGNED_DIR}"
  COMMAND ${CMAKE_COMMAND} -E echo "Signed Application: ${APP_SIGNED_DIR}"
  COMMAND ${CMAKE_COMMAND} -E echo "========================================================================"
  VERBATIM
)

# Ensure signing depends on ELF generation (if running in same build)
add_dependencies(sign post_process_elf)
```

## Kconfig
```
# Copyright (c) Qualcomm Technologies, Inc. and/or its subsidiaries.
# SPDX-License-Identifier: BSD-3-Clause-Clear

menu "Zephyr"
source "Kconfig.zephyr"
endmenu

module = APP
module-str = Application
source "subsys/logging/Kconfig.template.log_config"

config WIFI_SAMPLE_SSID
	string "SSID of the target AP"
	help
	  SSID of the access point to connect to in station mode.
	  For example: "TARGET-AP"

config WIFI_SAMPLE_PSK
	string "Pre-shared key for target AP"
	help
	  WPA2 password used to connect to the target AP.
	  For example: "PSK"
```

## sample.yaml
```
sample:
  description: QCC730 WiFi app
    application
  name: WiFi app 
common:
  tags: introduction
  harness: console
```

## prj.conf
```kconfig
# Copyright (c) Qualcomm Technologies, Inc. and/or its subsidiaries.
# SPDX-License-Identifier: BSD-3-Claus

CONFIG_NETWORKING=y
CONFIG_NET_IPV4=y
CONFIG_NET_IPV6=y
CONFIG_NET_TCP=y
CONFIG_NET_UDP=y
CONFIG_NET_MGMT=y
CONFIG_NET_CONFIG_AUTO_INIT=n
CONFIG_ETH_DRIVER=n
CONFIG_TEST_RANDOM_GENERATOR=y
CONFIG_NET_L2_ETHERNET=y
CONFIG_NET_SHELL=y
# dhcp
CONFIG_NET_DHCPV4=y
CONFIG_NET_DHCPV4_SERVER=y
CONFIG_WIFI_QCOM_AUTO_DHCPV4=y

CONFIG_WIFI=y
CONFIG_WIFI_QCOM=y
CONFIG_NET_L2_WIFI_SHELL=y
CONFIG_NET_MGMT_EVENT_QUEUE_TIMEOUT=5000
CONFIG_NET_MGMT_EVENT_QUEUE_SIZE=16
CONFIG_NET_L2_WIFI_MGMT=y

CONFIG_MAIN_STACK_SIZE=2048

CONFIG_WIFI_SAMPLE_SSID=""
CONFIG_WIFI_SAMPLE_PSK=""

CONFIG_NET_LOG=y
CONFIG_NET_L2_ETHERNET_LOG_LEVEL_DBG=n
CONFIG_NET_L2_WIFI_MGMT_LOG_LEVEL_DBG=y
CONFIG_NET_MGMT_EVENT_LOG_LEVEL_DBG=n
CONFIG_WIFI_LOG_LEVEL_DBG=y

# increase CONFIG_NET_BUF_DATA_SIZE to 512, allow more net buffer allocated.
CONFIG_NET_BUF_DATA_SIZE=512
# increase NET_MGMT_EVENT_STACK_SIZE to 1024, fix potential stack overflow issues.
CONFIG_NET_MGMT_EVENT_STACK_SIZE=1024
# increase SYSTEM_WORKQUEUE_STACK_SIZE to 2048, fix potential stack overflow issues.
CONFIG_SYSTEM_WORKQUEUE_STACK_SIZE=2048

# zperf
CONFIG_NET_ZPERF=y
CONFIG_NET_ZPERF_SERVER=y
# allow more ZVFS_POLL
CONFIG_ZVFS_POLL_MAX=16

CONFIG_NET_ZPERF_MAX_PACKET_SIZE=1500

CONFIG_FLASH=y
CONFIG_FLASH_QCC730=y
CONFIG_BOARD_QCC730_UART_GPIO_OPTION=1
CONFIG_PM_DEVICE=y

CONFIG_CODE_DATA_RELOCATION=y
CONFIG_DP_RAM_LOCATED=y

CONFIG_NET_PKT_TX_COUNT=40
CONFIG_NET_PKT_RX_COUNT=40
CONFIG_NET_BUF_TX_COUNT=40
CONFIG_NET_BUF_RX_COUNT=40
CONFIG_NET_BUF_DATA_SIZE=1500
CONFIG_NET_TCP_MAX_SEND_WINDOW_SIZE=20000
CONFIG_SYS_HEAP_RUNTIME_STATS=y
CONFIG_NET_BUF_POOL_USAGE=y
CONFIG_NET_DISABLE_ICMP_DESTINATION_UNREACHABLE=y

CONFIG_QCRYPTO=y
CONFIG_MBEDTLS=y
CONFIG_MBEDTLS_TEST=y

# ============================================
# MCUmgr Configuration
# ============================================
# ZCBOR - required for MCUmgr
CONFIG_ZCBOR=y
CONFIG_ZCBOR_CANONICAL=y

# MCUmgr Core - basic MCUmgr support
CONFIG_MCUMGR=y

# two wifi drv iface support
CONFIG_WIFI_NM=y
CONFIG_NET_IF_MAX_IPV6_COUNT=2
CONFIG_NET_IF_MAX_IPV4_COUNT=2
CONFIG_NET_IF_MCAST_IPV6_ADDR_COUNT=4
```

## src/main.c
```c
/*
 * Copyright (c) Qualcomm Technologies, Inc. and/or its subsidiaries.
 *
 * SPDX-License-Identifier: BSD-3-Clause-Clear
 */

#include <zephyr/kernel.h>
#include <zephyr/logging/log.h>
#include <zephyr/net/wifi_mgmt.h>

LOG_MODULE_REGISTER(MAIN);

#define MACSTR "%02X:%02X:%02X:%02X:%02X:%02X"

#define NET_EVENT_WIFI_MASK                                                                        \
	(NET_EVENT_WIFI_CONNECT_RESULT | NET_EVENT_WIFI_DISCONNECT_RESULT |                        \
	 NET_EVENT_WIFI_SCAN_RESULT | NET_EVENT_WIFI_SCAN_DONE | NET_EVENT_WIFI_RAW_SCAN_RESULT)

struct scan_context {
	int scan_result;
};

static struct scan_context scan_context;
static K_SEM_DEFINE(scan_sem, 0, 1);

static struct wifi_connect_req_params sta_config;
static struct net_mgmt_event_callback wifi_event_cb;

/* Check necessary definitions */
BUILD_ASSERT(sizeof(CONFIG_WIFI_SAMPLE_SSID) > 1,
	     "CONFIG_WIFI_SAMPLE_SSID is empty. Please set it in conf file.");

static void handle_wifi_scan_result(struct net_mgmt_event_callback *cb)
{
	const struct wifi_scan_result *entry =
		(const struct wifi_scan_result *)cb->info;
	char mac_string_buf[sizeof("xx:xx:xx:xx:xx:xx")];
	uint8_t ssid_print[WIFI_SSID_MAX_LEN + 1];

	scan_context.scan_result++;

	if (scan_context.scan_result == 1U) {
		printk("\n%-4s | %-32s %-5s | %-13s | %-4s | %-20s | %-17s | %-8s\n",
		   "Num", "SSID", "(len)", "Chan (Band)", "RSSI", "Security", "BSSID", "MFP");
	}

	snprintk(ssid_print, sizeof(ssid_print), "%s", entry->ssid);
	if (entry->mac_length) {
		snprintk(mac_string_buf, sizeof(mac_string_buf), MACSTR,
			 entry->mac[0], entry->mac[1], entry->mac[2], entry->mac[3],
			 entry->mac[4], entry->mac[5]);
	}

	printk("%-4d | %-32s %-5u | %-4u (%-6s) | %-4d | %-20s | %-17s | %-8s\n",
	   scan_context.scan_result, ssid_print, entry->ssid_length, entry->channel,
	   wifi_band_txt(entry->band),
	   entry->rssi,
	   ((entry->wpa3_ent_type) ?
		wifi_wpa3_enterprise_txt(entry->wpa3_ent_type)
		 : (entry->security == WIFI_SECURITY_TYPE_EAP ? "WPA2 Enterprise"
		 : wifi_security_txt(entry->security))),
	   ((entry->mac_length) ? mac_string_buf : ""),
	   wifi_mfp_txt(entry->mfp));
}


static void wifi_event_handler(struct net_mgmt_event_callback *cb, uint64_t mgmt_event,
			       struct net_if *iface)
{
	switch (mgmt_event) {
	case NET_EVENT_WIFI_CONNECT_RESULT: {
		LOG_INF("Connected to %s", CONFIG_WIFI_SAMPLE_SSID);
		break;
	}
	case NET_EVENT_WIFI_DISCONNECT_RESULT: {
		LOG_INF("Disconnected from %s", CONFIG_WIFI_SAMPLE_SSID);
		break;
	}
	case NET_EVENT_WIFI_SCAN_RESULT: {
		handle_wifi_scan_result(cb);
		break;
	}
	case NET_EVENT_WIFI_SCAN_DONE: {
		LOG_INF("Scan done");
		k_sem_give(&scan_sem);
		break;
	}
	default:
		break;
	}
}

static int scan_wifi()
{
	struct wifi_scan_params params = { 0 };
	struct net_if *sta_iface = net_if_get_wifi_sta();
	if (!sta_iface) {
		LOG_INF("STA: interface no initialized");
		return -EIO;
	}

	scan_context.scan_result = 0;
	if (net_mgmt(NET_REQUEST_WIFI_SCAN, sta_iface, &params, sizeof(params))) {
		LOG_ERR("Scan request failed\n");
		return -ENOEXEC;
	}

	k_sem_take(&scan_sem, K_FOREVER);

	return 0;
}

static int connect_to_wifi()
{
	struct net_if *sta_iface = net_if_get_wifi_sta();
	if (!sta_iface) {
		LOG_INF("STA: interface no initialized");
		return -EIO;
	}

	sta_config.ssid = (const uint8_t *)CONFIG_WIFI_SAMPLE_SSID;
	sta_config.ssid_length = sizeof(CONFIG_WIFI_SAMPLE_SSID) - 1;
	sta_config.psk = (const uint8_t *)CONFIG_WIFI_SAMPLE_PSK;
	sta_config.psk_length = sizeof(CONFIG_WIFI_SAMPLE_PSK) - 1;
	sta_config.security = WIFI_SECURITY_TYPE_PSK;
	sta_config.channel = WIFI_CHANNEL_ANY;

	LOG_INF("Connecting to SSID: %s\n", sta_config.ssid);

	int ret = net_mgmt(NET_REQUEST_WIFI_CONNECT, sta_iface, &sta_config,
			   sizeof(struct wifi_connect_req_params));
	if (ret) {
		LOG_ERR("Unable to Connect to (%s)", CONFIG_WIFI_SAMPLE_SSID);
	}

	return ret;
}

int main(void)
{
	net_mgmt_init_event_callback(&wifi_event_cb, wifi_event_handler, NET_EVENT_WIFI_MASK);
	net_mgmt_add_event_callback(&wifi_event_cb);

	scan_wifi();

	connect_to_wifi();

	return 0;
}
```
