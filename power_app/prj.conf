## CMakeLists.txt
```
# Copyright (c) Qualcomm Technologies, Inc. and/or its subsidiaries.
# SPDX-License-Identifier: BSD-3-Clause-Clear

cmake_minimum_required(VERSION 3.20.0)

find_package(Zephyr REQUIRED HINTS $ENV{ZEPHYR_BASE})
project(power_app)

target_sources(app PRIVATE src/main.c)

# ===== Post-build: run Python script for hex/strip/bin/hashed =====
find_package(Python3 COMPONENTS Interpreter REQUIRED)

set(POST_PY "${ZEPHYR_HAL_QCOM_MODULE_DIR}/tools/post_process.py")
set(HASH_SCRIPT "${ZEPHYR_HAL_QCOM_MODULE_DIR}/tools/qhash/sechash/createxbl.py")
set(SBL_TOOL_PREFIX "${ZEPHYR_SDK_INSTALL_DIR}/arm-zephyr-eabi/bin/arm-zephyr-eabi")

set(APP_OUT_DIR "${APPLICATION_BINARY_DIR}/zephyr")
set(HASHED_ELF_BASENAME "zephyr_HASHED.elf")
set(HASHED_ELF "${APP_OUT_DIR}/${HASHED_ELF_BASENAME}")

# Use add_custom_command for incremental build support
add_custom_command(
  OUTPUT "${HASHED_ELF}"
  COMMAND "${Python3_EXECUTABLE}" "${POST_PY}"
          --elf "${APPLICATION_BINARY_DIR}/zephyr/zephyr.elf"
          --tool-prefix "${SBL_TOOL_PREFIX}"
          --hash-script "${HASH_SCRIPT}"
          --hashed-out "${HASHED_ELF}"
          --check-noinit
  DEPENDS zephyr_final "${APPLICATION_BINARY_DIR}/zephyr/zephyr.elf"
  COMMENT "Post-process ELF and generate hashed ELF"
  VERBATIM
)

# Use zephyr_final target which is created by Zephyr build system
add_custom_target(post_process_elf ALL DEPENDS "${HASHED_ELF}")

# ===== Signing support: Manual target "sign" =====
# Usage: west build -b qcc730mi -t sign
# This allows signing without rebuilding/reconfiguring the project

# Paths to sectools
set(SECTOOLS_DIR "${ZEPHYR_HAL_QCOM_MODULE_DIR}/tools/sectools")
set(SECTOOLS_SCRIPT "${SECTOOLS_DIR}/sectools.py")
set(SECTOOLS_CONFIG "${ZEPHYR_HAL_QCOM_MODULE_DIR}/tools/sectools/config/qcc730/qcc730_secimage.xml")

# Input ELF files
set(SBL_ELF "${APPLICATION_BINARY_DIR}/modules/hal_qcom/qboot/${BOARD}_sbl.elf")
set(APP_ELF "${APPLICATION_BINARY_DIR}/zephyr/zephyr.elf")

# Output directories
set(SBL_SIGNED_DIR "${APPLICATION_BINARY_DIR}/modules/hal_qcom/qboot/zephyr_sec_sbl")
set(APP_SIGNED_DIR "${APPLICATION_BINARY_DIR}/zephyr/zephyr_sec_app")

# Output files (based on sectools output structure)
set(SBL_SIGNED_BIN "${SBL_SIGNED_DIR}/qcc730/sbl/${BOARD}_sbl.elf")
set(APP_SIGNED_BIN "${APP_SIGNED_DIR}/qcc730/app/zephyr.elf")

# Sign SBL image custom command
add_custom_command(
  OUTPUT "${SBL_SIGNED_BIN}"
  COMMAND "${Python3_EXECUTABLE}" "${SECTOOLS_SCRIPT}"
          secimage
          -i "${SBL_ELF}"
          -c "${SECTOOLS_CONFIG}"
          -sa
          -g sbl
          -o "${SBL_SIGNED_DIR}"
  WORKING_DIRECTORY "${SECTOOLS_DIR}"
  DEPENDS "${SBL_ELF}"
  COMMENT "Signing SBL image with sectools"
  VERBATIM
)

# Sign application image custom command
add_custom_command(
  OUTPUT "${APP_SIGNED_BIN}"
  COMMAND "${Python3_EXECUTABLE}" "${SECTOOLS_SCRIPT}"
          secimage
          -i "${APP_ELF}"
          -c "${SECTOOLS_CONFIG}"
          -sa
          -g app
          -o "${APP_SIGNED_DIR}"
  WORKING_DIRECTORY "${SECTOOLS_DIR}"
  DEPENDS "${APP_ELF}"
  COMMENT "Signing application image with sectools"
  VERBATIM
)

# Define "sign" target that triggers signing
# NOT added to ALL, so it won't run by default
add_custom_target(sign
  DEPENDS "${SBL_SIGNED_BIN}" "${APP_SIGNED_BIN}"
  COMMAND ${CMAKE_COMMAND} -E echo "========================================================================"
  COMMAND ${CMAKE_COMMAND} -E echo "✓ Signing completed successfully!"
  COMMAND ${CMAKE_COMMAND} -E echo "========================================================================"
  COMMAND ${CMAKE_COMMAND} -E echo "Signed SBL:         ${SBL_SIGNED_DIR}"
  COMMAND ${CMAKE_COMMAND} -E echo "Signed Application: ${APP_SIGNED_DIR}"
  COMMAND ${CMAKE_COMMAND} -E echo "========================================================================"
  VERBATIM
)

# Ensure signing depends on ELF generation (if running in same build)
add_dependencies(sign post_process_elf)
```

## Kconfig
```
# Copyright (c) Qualcomm Technologies, Inc. and/or its subsidiaries.
# SPDX-License-Identifier: BSD-3-Clause-Clear

menu "Zephyr"
source "Kconfig.zephyr"
endmenu

module = APP
module-str = Application
source "subsys/logging/Kconfig.template.log_config"


config APP_PROVIDE_PM_HOOKS
	bool "Application provides PM hooks"
	default y
	select HAS_PM
```

## sample.yaml
```
sample:
  description: QCC730 Power app
    application
  name: power app 
common:
  tags: introduction
  harness: console
```

## prj.conf
```kconfig
# Copyright (c) Qualcomm Technologies, Inc. and/or its subsidiaries.
# SPDX-License-Identifier: BSD-3-Clause-Clear

# nothing here
CONFIG_PM=y
CONFIG_STATS=y
CONFIG_PM_STATS=y
# CONFIG_PM_S2RAM=y

# counter driver.
CONFIG_COUNTER=y
# avoid stack overflow in the idle task thread.
CONFIG_IDLE_STACK_SIZE=512

CONFIG_WIFI=y
CONFIG_WIFI_QCOM=y
CONFIG_QCRYPTO=y
CONFIG_NET_L2_WIFI_MGMT=y
CONFIG_NET_L2_ETHERNET=y
CONFIG_NETWORKING=y
CONFIG_NET_IPV4=y
#CONFIG_NET_IPV6=y
CONFIG_NET_TCP=y
CONFIG_NET_UDP=y
CONFIG_NET_MGMT=y
#CONFIG_NET_CONFIG_AUTO_INIT=n
CONFIG_ETH_DRIVER=n
CONFIG_TEST_RANDOM_GENERATOR=y
CONFIG_NET_L2_ETHERNET=y
CONFIG_NET_SHELL=y
# dhcp
CONFIG_NET_DHCPV4=y
CONFIG_NET_DHCPV4_SERVER=y
CONFIG_WIFI_QCOM_AUTO_DHCPV4=y

CONFIG_WIFI=y
CONFIG_WIFI_QCOM=y
CONFIG_NET_L2_WIFI_SHELL=y
CONFIG_NET_L2_WIFI_MGMT=y

CONFIG_FLASH=y
CONFIG_FLASH_QCC730=y
CONFIG_BOARD_QCC730_UART_GPIO_OPTION=1
CONFIG_PM_DEVICE=y

# two wifi drv iface support
CONFIG_WIFI_NM=y
CONFIG_NET_IF_MAX_IPV6_COUNT=2
CONFIG_NET_IF_MAX_IPV4_COUNT=2
CONFIG_NET_IF_MCAST_IPV6_ADDR_COUNT=4
```

## src/main.c
```c
/*
 * Copyright (c) Qualcomm Technologies, Inc. and/or its subsidiaries.
 *
 * SPDX-License-Identifier: BSD-3-Clause-Clear
 */

#include <zephyr/shell/shell.h>
#include <zephyr/sys/util.h>
#include <zephyr/pm/pm.h>
#include <stdio.h>
#include "qpower.h"
#include <stdlib.h>
#include <stdbool.h>
#include <qlib_util.h>

#include <zephyr/kernel.h>
#include <zephyr/logging/log.h>
#include <zephyr/pm/policy.h>
#include <zephyr/sys_clock.h>

// #define PM_SLEEP_BY_LATENCY

LOG_MODULE_REGISTER(app, CONFIG_APP_LOG_LEVEL);

#ifdef PM_SLEEP_BY_LATENCY
static void on_latency_changed(int32_t latency)
{
    if (latency == SYS_FOREVER_US) {
        LOG_INF("Latency constraint changed: none");
    } else {
        LOG_INF("Latency constraint changed: %" PRId32 "ms", latency / USEC_PER_MSEC);
    }
}
#endif

int main(void)
{
#ifdef PM_SLEEP_BY_LATENCY
    // softoff: latency=500ms, residency=3000ms
    int sleep_ms = 8000;
    int sleep_pm_active_ms = 2000;
    struct pm_policy_latency_subscription subs;
    struct pm_policy_latency_request req;
#endif

    k_sleep(K_MSEC(1));
    LOG_INF("Hello World! %s", CONFIG_BOARD_TARGET);

#ifdef PM_SLEEP_BY_LATENCY
    dead_loop_cond1();

    pm_policy_latency_changed_subscribe(&subs, on_latency_changed);
    LOG_INF("Setting latency constraint: 30ms");
    pm_policy_latency_request_add(&req, 30000);
    LOG_INF("Sleeping for %d seconds, we should stay ACTIVE due to latency constraint", sleep_ms / 1000);
    k_msleep(sleep_ms);

    LOG_INF("Setting latency constraint: 1000ms");
    pm_policy_latency_request_update(&req, 1000000);
    LOG_INF("Sleeping for %d seconds, we should stay ACTIVE due to residency constraint", sleep_pm_active_ms / 1000);
    k_msleep(sleep_pm_active_ms);

    LOG_INF("Sleeping for %d seconds, we should enter softoff or susmpend2ram", sleep_ms / 1000);
    dead_loop_cond1();
    k_msleep(sleep_ms);

    LOG_ERR("Should not reach here. Now actually reach here because idle timeout are less than softoff or suspend2ram "
            "residence");
#endif

    return 0;
}
```
