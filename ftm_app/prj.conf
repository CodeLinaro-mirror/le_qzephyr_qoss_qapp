## CMakeLists.txt
```
# Copyright (c) Qualcomm Technologies, Inc. and/or its subsidiaries.
# SPDX-License-Identifier: BSD-3-Clause-Clear

cmake_minimum_required(VERSION 3.20.0)

find_package(Zephyr REQUIRED HINTS $ENV{ZEPHYR_BASE})
project(ftm_app)

target_sources(app PRIVATE 
    src/main.c
)
```

## Kconfig
```
# Copyright (c) Qualcomm Technologies, Inc. and/or its subsidiaries.
# SPDX-License-Identifier: BSD-3-Clause

menu "Zephyr"
source "Kconfig.zephyr"
source "modules/segger/Kconfig"

config FTM_MODE
    bool "Enable FTM Mode"
    default n

config 6G_BAND
    bool "Enable 6G Band"
    default n

config SOC_FAMILY_QCOM
    bool "Enable SOC_FAMILY_QCOM"
    default n

config QWIFI
    bool "Enable QWIFI"
    default n

config QURT_ABSTRACTION_LAYER
    bool "Enable QURT_ABSTRACTION_LAYER"
    default n

config QSYSTEM
    bool "Enable QSYSTEM"
    default n

config QHW_SUPPORT
    bool "Enable QHW_SUPPORT"
    default n

config QPOWER
    bool "Enable QPOWER"
    default n

# uart polling
config UART_INTERRUPT_DRIVEN
    bool "Enable UART_INTERRUPT_DRIVEN"
    default n

config FTM_UART_BAUDRATE
    int "FTM UART baud rate"
    default 115200
    help
      The baud rate for FTM UART communication.

config FTM_RX_BUFFER_SIZE
    int "FTM RX buffer size"
    default 256
    help
      Size of the receive buffer for FTM data.

config FTM_TX_BUFFER_SIZE
    int "FTM TX buffer size"
    default 256
    help
      Size of the transmit buffer for FTM data.

config FTM_POLL_INTERVAL_MS
    int "FTM UART poll interval (ms)"
    default 10
    help
      Interval for polling UART in milliseconds.

endmenu

module = APP
module-str = Application
source "subsys/logging/Kconfig.template.log_config"
source "modules/openthread/Kconfig"
```

## prj.conf
```kconfig
# Copyright (c) Qualcomm Technologies, Inc. and/or its subsidiaries.
# SPDX-License-Identifier: BSD-3-Claus

# nothing here

CONFIG_FTM_MODE=y

CONFIG_NETWORKING=y
CONFIG_NET_TCP=y
CONFIG_NET_UDP=y
CONFIG_NET_L2_ETHERNET=y
CONFIG_WIFI=y
CONFIG_WIFI_QCOM=y
CONFIG_QCRYPTO=y

# Serial/UART Configuration
CONFIG_SERIAL=y
CONFIG_PRINTK=y
CONFIG_CONSOLE=y
CONFIG_UART_LINE_CTRL=y
CONFIG_UART_INTERRUPT_DRIVEN=n
CONFIG_LOG_MODE_DEFERRED=y
CONFIG_LOG_PROCESS_THREAD=y

# FTM Application Configuration
CONFIG_FTM_UART_BAUDRATE=115200

# Logging
CONFIG_LOG=y
CONFIG_LOG_DEFAULT_LEVEL=3
CONFIG_LOG_BACKEND_UART=n

# Main Stack Size
CONFIG_MAIN_STACK_SIZE=2048

#RTT
CONFIG_COUNTER=y
CONFIG_IDLE_STACK_SIZE=512
# enable SEGGER RTT
CONFIG_SHELL=y
CONFIG_USE_SEGGER_RTT=y
CONFIG_SHELL_BACKEND_SERIAL=n
CONFIG_SHELL_BACKEND_RTT=y
CONFIG_RTT_CONSOLE=y
CONFIG_UART_CONSOLE=n

CONFIG_ENTROPY_GENERATOR=y
CONFIG_TEST_RANDOM_GENERATOR=y

# two wifi drv iface support
CONFIG_WIFI_NM=y
CONFIG_NET_IF_MAX_IPV6_COUNT=2
# CONFIG_NET_IF_MAX_IPV4_COUNT=2 (unused: NET_IPV4=n in this app)
CONFIG_NET_IF_MCAST_IPV6_ADDR_COUNT=4
```

## src/main.c
```c
/*
 * Copyright (c) Qualcomm Technologies, Inc. and/or its subsidiaries.
 *
 * SPDX-License-Identifier: BSD-3-Clause-Clear
 */

#include <zephyr/shell/shell.h>
#include <zephyr/sys/util.h>
#include <stdio.h>
#include <stdlib.h>
#include <stdbool.h>

#include <zephyr/kernel.h>
#include <zephyr/logging/log.h>

int main(void)
{
    printk("Hello World! %s\n", CONFIG_BOARD_TARGET);
    return 0;
}
```

## include/ftm_uart_polling.h
```c
/**
 * @file ftm_uart.h
 * @brief UART Driver Wrapper for FTM Application
 * 
 * This file provides a polling-based UART interface for the FTM application.
 */

#ifndef FTM_UART_H
#define FTM_UART_H

#include <zephyr/kernel.h>
#include <zephyr/types.h>
#include <stddef.h>

#ifdef __cplusplus
extern "C" {
#endif

void ftm_task_init(void);
void ftm_uart_init(void);
void uart_polling_receive(void);

#ifdef __cplusplus
}
#endif

#endif /* FTM_UART_H */
```

## src/ftm_uart_polling.c
```c
/**
 * @file ftm_uart_pollling.c
 * @brief UART Driver Wrapper Implementation for FTM Application
 */

#include <stdint.h>
#include <zephyr/kernel.h>
#include <ftm_uart_polling.h>
#include <zephyr/device.h>
#include <zephyr/drivers/uart.h>
#include <string.h>
#include <zephyr/logging/log.h>
#include "printfext.h"

#if (defined FTM_OVER_UART)
#ifdef cmdMAX_INPUT_SIZE
#undef cmdMAX_INPUT_SIZE
#endif
#define cmdMAX_INPUT_SIZE (1024 * 2)
#define UART_POLL_INTERVAL_MS 10
volatile uint8_t cInputString[cmdMAX_INPUT_SIZE] __attribute__((aligned(4)));
volatile uint16_t cInputIndex = 0;
uint16_t cInputLength = 0;
struct diag_pkt {
    size_t len;
    uint8_t buf[cmdMAX_INPUT_SIZE] __attribute__((aligned(4)));
};
#endif
#define UART_TERMINATION_CHAR 0x7E

static const struct device *uart_dev = NULL;
#define configUART_COMMAND_CONSOLE_STACK_SIZE		( 1024*2 )
#define configUART_COMMAND_CONSOLE_TASK_PRIORITY	( 7U )

static k_tid_t FTM_Task_handle;
K_THREAD_STACK_DEFINE(ftm_stack, configUART_COMMAND_CONSOLE_STACK_SIZE);
static struct k_thread ftm_thread;

K_FIFO_DEFINE(diag_fifo);
static k_tid_t Diag_Task_handle;
K_THREAD_STACK_DEFINE(diag_stack, configUART_COMMAND_CONSOLE_STACK_SIZE);
static struct k_thread diag_thread;

void ftm_task_init(void);
static void ftm_task(void *pvParameters1, void *pvParameters2, void *pvParameters3);
static void diag_task(void *pvParameters1, void *pvParameters2, void *pvParameters3);
void ftm_uart_init(void);
void uart_polling_receive(void);
extern int processDiagPacket(int client, unsigned char *inputMsg, unsigned int cmdLen);


void ftm_task_init(void)
{
    printk("Build FTM lib date and time: %s - %s\n", __DATE__, __TIME__);
    
    FTM_Task_handle = k_thread_create(
        &ftm_thread,
        ftm_stack,
        K_THREAD_STACK_SIZEOF(ftm_stack),
        ftm_task,
        NULL, NULL, NULL,
        configUART_COMMAND_CONSOLE_TASK_PRIORITY,
        0, K_NO_WAIT
    );

    if (FTM_Task_handle == NULL) {
        printk("ERROR: FTM task creation failed!\n");
        return;
    }
    k_thread_name_set(FTM_Task_handle, "FTM_Task");
    
    Diag_Task_handle = k_thread_create(
        &diag_thread,
        diag_stack,
        K_THREAD_STACK_SIZEOF(diag_stack),
        diag_task,
        NULL, NULL, NULL,
        configUART_COMMAND_CONSOLE_TASK_PRIORITY,
        0, K_NO_WAIT
    );
    
    if (Diag_Task_handle == NULL) {
        printk("ERROR: Diag task creation failed!\n");
        return;
    }
    k_thread_name_set(Diag_Task_handle, "Diag_Task");

    printk("FTM & Diag task created successfully!\n");
}

void ftm_uart_init(void)
{
    int ret;

    uart_dev = DEVICE_DT_GET(DT_NODELABEL(uart0));
    if (!device_is_ready(uart_dev)) {
        printk("uart0 device not ready\n");
        return;
    }

    struct uart_config uart_cfg = {
        .baudrate = CONFIG_FTM_UART_BAUDRATE,
        .parity = UART_CFG_PARITY_NONE,
        .stop_bits = UART_CFG_STOP_BITS_1,
        .data_bits = UART_CFG_DATA_BITS_8,
        .flow_ctrl = UART_CFG_FLOW_CTRL_NONE
    };

    ret = uart_configure(uart_dev, &uart_cfg);
    if (ret != 0) {
        printk("Failed to configure UART: %d", ret);
        return;
    }

    uart_irq_rx_disable(uart_dev);
    uart_irq_tx_disable(uart_dev);
    
}

void uart_polling_receive(void)
{
    uint8_t data;
    int ret;
    static uint32_t no_data_count = 0;

    for(;;){
        ret = uart_poll_in(uart_dev, &data);
    
        
        if (ret == 0) {
            if (cInputIndex < cmdMAX_INPUT_SIZE) {
                cInputString[cInputIndex] = data;
                cInputIndex++;
            }else {
                printk("ERROR: UART buffer overflow, resetting\n");
                cInputIndex = 0;
                continue;
            }
            
            if (data == UART_TERMINATION_CHAR) {
                cInputLength = cInputIndex;
                printk("RX receive length: %d\n",cInputLength);
                k_msleep(1);

                struct diag_pkt *pkt = k_malloc(sizeof(struct diag_pkt));
                if (pkt) {
                    if (cInputLength > cmdMAX_INPUT_SIZE) {
                        printk("ERROR: Invalid packet length %d\n", cInputLength);
                        k_free(pkt);
                        cInputIndex = 0;
                        continue;
                    }
                    pkt->len = cInputLength;
                    memcpy(pkt->buf, cInputString, cInputLength);
                    k_fifo_put(&diag_fifo, pkt);
                }else{
                    printk("pkt malloc fail!\n");
                    cInputIndex = 0;
                    k_msleep(10);
                    continue;
                }
                
                cInputIndex = 0;
            }
            continue;
        } else if (ret < 0) {
            k_busy_wait(200);
            no_data_count++;
            if (no_data_count == 5) {
                no_data_count = 0;
                k_yield();
            }
        }
    }
}

static void ftm_task(void *pvParameters1, void *pvParameters2, void *pvParameters3)
{
    PRINT_LOG_FUNC_LINE_ENTRY;
    ftm_uart_init();

    uart_polling_receive();

}

static void diag_task(void *pvParameters1, void *pvParameters2, void *pvParameters3)
{
    PRINT_LOG_FUNC_LINE_ENTRY;
    for (;;) {
        struct diag_pkt *pkt = k_fifo_get(&diag_fifo, K_FOREVER);
        if (!pkt) continue;

        processDiagPacket(0, pkt->buf, pkt->len);

        k_free(pkt);
    }
}
```
